&sensor {
	sen_sc500ai: sen_sc500ai {
		sen_mode = <1>;
		fps = <3000>;
		expt = <10000>;
		gain = <1000>;
		mirror = <0>;
		flip = <0>;
		mclk_src = <0>;
		mclk_clk = <27000000>;
		pwdn_pin = <0xFFFFFFFF>;
		rst_pin = <0x32>;
		rst_time = <1>;
		stable_time = <1>;
		ob = <260>;
		i2c_id = <2>;
		i2c_addr = <0x30>;
		row_time = <106>;
		pclk = <158400000>;
		hdr_en = <0>;
		data_fmt = <1>;
		mode_type = <1>;
		dft_fps = <3000>;
		frame_num = <1>;
		valid_size_w = <2880>;
		valid_size_h = <1624>;
		act_size_x = <0>;
		act_size_y = <2>;
		act_size_w = <2880>;
		act_size_h = <1620>;
		crp_size_w = <2880>;
		crp_size_h = <1620>;
		hd = <1600>;
		vd = <1650>;
		max_gain = <764127>;
		min_gain = <1000>;
		max_vd = <65535>;
		min_expt = <1>;
		cmd = [
			03 30 00 00 01 03 01 00
			03 30 00 00 01 00 00 00
			03 30 00 00 36 E9 80 00
			03 30 00 00 36 F9 80 00
			03 30 00 00 30 1F 01 00
			03 30 00 00 32 0B 58 00
			03 30 00 00 32 11 03 00
			03 30 00 00 32 13 01 00
			03 30 00 00 32 53 0A 00
			03 30 00 00 33 01 0A 00
			03 30 00 00 33 02 18 00
			03 30 00 00 33 03 10 00
			03 30 00 00 33 04 60 00
			03 30 00 00 33 06 60 00
			03 30 00 00 33 08 10 00
			03 30 00 00 33 09 70 00
			03 30 00 00 33 0A 00 00
			03 30 00 00 33 0B F0 00
			03 30 00 00 33 0D 18 00
			03 30 00 00 33 0E 20 00
			03 30 00 00 33 0F 02 00
			03 30 00 00 33 10 02 00
			03 30 00 00 33 1C 04 00
			03 30 00 00 33 1E 51 00
			03 30 00 00 33 1F 61 00
			03 30 00 00 33 20 09 00
			03 30 00 00 33 33 10 00
			03 30 00 00 33 4C 08 00
			03 30 00 00 33 56 09 00
			03 30 00 00 33 64 17 00
			03 30 00 00 33 6D 03 00
			03 30 00 00 33 90 08 00
			03 30 00 00 33 91 18 00
			03 30 00 00 33 92 38 00
			03 30 00 00 33 93 0A 00
			03 30 00 00 33 94 20 00
			03 30 00 00 33 95 20 00
			03 30 00 00 33 96 08 00
			03 30 00 00 33 97 18 00
			03 30 00 00 33 98 38 00
			03 30 00 00 33 99 0A 00
			03 30 00 00 33 9A 20 00
			03 30 00 00 33 9B 20 00
			03 30 00 00 33 9C 20 00
			03 30 00 00 33 AC 10 00
			03 30 00 00 33 AE 10 00
			03 30 00 00 33 AF 19 00
			03 30 00 00 36 0F 01 00
			03 30 00 00 36 22 03 00
			03 30 00 00 36 3A 1F 00
			03 30 00 00 36 3C 40 00
			03 30 00 00 36 51 7D 00
			03 30 00 00 36 70 0A 00
			03 30 00 00 36 71 07 00
			03 30 00 00 36 72 17 00
			03 30 00 00 36 73 1E 00
			03 30 00 00 36 74 82 00
			03 30 00 00 36 75 64 00
			03 30 00 00 36 76 66 00
			03 30 00 00 36 7A 48 00
			03 30 00 00 36 7B 78 00
			03 30 00 00 36 7C 58 00
			03 30 00 00 36 7D 78 00
			03 30 00 00 36 90 34 00
			03 30 00 00 36 91 34 00
			03 30 00 00 36 92 54 00
			03 30 00 00 36 9C 48 00
			03 30 00 00 36 9D 78 00
			03 30 00 00 36 EC 1A 00
			03 30 00 00 39 04 04 00
			03 30 00 00 39 08 41 00
			03 30 00 00 39 1D 04 00
			03 30 00 00 39 C2 30 00
			03 30 00 00 3E 01 CD 00
			03 30 00 00 3E 02 C0 00
			03 30 00 00 3E 16 00 00
			03 30 00 00 3E 17 80 00
			03 30 00 00 45 00 88 00
			03 30 00 00 45 09 20 00
			03 30 00 00 57 99 00 00
			03 30 00 00 59 E0 60 00
			03 30 00 00 59 E1 08 00
			03 30 00 00 59 E2 3F 00
			03 30 00 00 59 E3 18 00
			03 30 00 00 59 E4 18 00
			03 30 00 00 59 E5 3F 00
			03 30 00 00 59 E7 02 00
			03 30 00 00 59 E8 38 00
			03 30 00 00 59 E9 20 00
			03 30 00 00 59 EA 0C 00
			03 30 00 00 59 EC 08 00
			03 30 00 00 59 ED 02 00
			03 30 00 00 59 EE A0 00
			03 30 00 00 59 EF 08 00
			03 30 00 00 59 F4 18 00
			03 30 00 00 59 F5 10 00
			03 30 00 00 59 F6 0C 00
			03 30 00 00 59 F9 02 00
			03 30 00 00 59 FA 18 00
			03 30 00 00 59 FB 10 00
			03 30 00 00 59 FC 0C 00
			03 30 00 00 59 FF 02 00
			03 30 00 00 36 E9 1C 00
			03 30 00 00 36 F9 24 00
			03 30 00 00 01 00 01 00
			00 00 00 00
		];
		gain_cmd_oft = <840>;
		gain_cmd_size = <32>;
		expt_cmd_oft = <872>;
		expt_cmd_size = <40>;
	};
};

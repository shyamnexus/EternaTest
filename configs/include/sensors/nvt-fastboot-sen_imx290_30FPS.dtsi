&sensor {
	sen_imx290: sen_imx290 {
		sen_mode = <0>;
		fps = <3000>;
		expt = <10000>;
		gain = <1000>;
		mirror = <0>;
		flip = <0>;
		mclk_src = <0>;
		mclk_clk = <37125000>;
		pwdn_pin = <0xFFFFFFFF>;
		rst_pin = <0xC4>;
		rst_time = <1>;
		stable_time = <1>;
		ob = <240>;
		i2c_id = <2>;
		i2c_addr = <0x1A>;
		row_time = <296>;
		pclk = <148500000>;
		hdr_en = <0>;
		data_fmt = <1>;
		mode_type = <1>;
		dft_fps = <3000>;
		frame_num = <1>;
		valid_size_w = <1945>;
		valid_size_h = <1097>;
		act_size_x = <12>;
		act_size_y = <8>;
		act_size_w = <1920>;
		act_size_h = <1080>;
		crp_size_w = <1920>;
		crp_size_h = <1080>;
		hd = <4400>;
		vd = <1125>;
		max_gain = <4096000>;
		min_gain = <1000>;
		max_vd = <262143>;
		min_expt = <1>;
		cmd = [
			03 1A 00 00 30 00 01 00
			80 00 A6 0E
			03 1A 00 00 30 02 01 00
			80 00 A6 0E
			03 1A 00 00 30 05 01 00
			03 1A 00 00 30 07 00 00
			03 1A 00 00 30 09 02 00
			03 1A 00 00 30 0A F0 00
			03 1A 00 00 30 0F 00 00
			03 1A 00 00 30 10 21 00
			03 1A 00 00 30 12 64 00
			03 1A 00 00 30 13 00 00
			03 1A 00 00 30 16 09 00
			03 1A 00 00 30 18 65 00
			03 1A 00 00 30 19 04 00
			03 1A 00 00 30 1C 30 00
			03 1A 00 00 30 1D 11 00
			03 1A 00 00 30 46 01 00
			03 1A 00 00 30 4B 0A 00
			03 1A 00 00 30 55 00 00
			03 1A 00 00 30 5C 18 00
			03 1A 00 00 30 5D 03 00
			03 1A 00 00 30 5E 20 00
			03 1A 00 00 30 5F 01 00
			03 1A 00 00 30 70 02 00
			03 1A 00 00 30 71 11 00
			03 1A 00 00 30 9B 10 00
			03 1A 00 00 30 9C 22 00
			03 1A 00 00 30 A2 02 00
			03 1A 00 00 30 A6 20 00
			03 1A 00 00 30 A8 20 00
			03 1A 00 00 30 AA 20 00
			03 1A 00 00 30 AC 20 00
			03 1A 00 00 30 B0 43 00
			03 1A 00 00 31 19 9E 00
			03 1A 00 00 31 1C 1E 00
			03 1A 00 00 31 1E 08 00
			03 1A 00 00 31 28 05 00
			03 1A 00 00 31 29 00 00
			03 1A 00 00 31 3D 83 00
			03 1A 00 00 31 50 03 00
			03 1A 00 00 31 5E 1A 00
			03 1A 00 00 31 64 1A 00
			03 1A 00 00 31 7C 00 00
			03 1A 00 00 31 7E 00 00
			03 1A 00 00 31 EC 0E 00
			03 1A 00 00 32 B8 50 00
			03 1A 00 00 32 B9 10 00
			03 1A 00 00 32 BA 00 00
			03 1A 00 00 32 BB 04 00
			03 1A 00 00 32 C8 50 00
			03 1A 00 00 32 C9 10 00
			03 1A 00 00 32 CA 00 00
			03 1A 00 00 32 CB 04 00
			03 1A 00 00 33 2C D3 00
			03 1A 00 00 33 2D 10 00
			03 1A 00 00 33 2E 0D 00
			03 1A 00 00 33 58 06 00
			03 1A 00 00 33 59 E1 00
			03 1A 00 00 33 5A 11 00
			03 1A 00 00 33 60 1E 00
			03 1A 00 00 33 61 61 00
			03 1A 00 00 33 62 10 00
			03 1A 00 00 33 B0 50 00
			03 1A 00 00 33 B2 1A 00
			03 1A 00 00 33 B3 04 00
			03 1A 00 00 34 05 20 00
			03 1A 00 00 34 07 03 00
			03 1A 00 00 34 14 0A 00
			03 1A 00 00 34 18 49 00
			03 1A 00 00 34 19 04 00
			03 1A 00 00 34 2C 47 00
			03 1A 00 00 34 2D 00 00
			03 1A 00 00 34 30 0F 00
			03 1A 00 00 34 31 00 00
			03 1A 00 00 34 41 0C 00
			03 1A 00 00 34 42 0C 00
			03 1A 00 00 34 43 03 00
			03 1A 00 00 34 44 20 00
			03 1A 00 00 34 45 25 00
			03 1A 00 00 34 46 47 00
			03 1A 00 00 34 47 00 00
			03 1A 00 00 34 48 1F 00
			03 1A 00 00 34 49 00 00
			03 1A 00 00 34 4A 17 00
			03 1A 00 00 34 4B 00 00
			03 1A 00 00 34 4C 0F 00
			03 1A 00 00 34 4D 00 00
			03 1A 00 00 34 4E 17 00
			03 1A 00 00 34 4F 00 00
			03 1A 00 00 34 50 47 00
			03 1A 00 00 34 51 00 00
			03 1A 00 00 34 52 0F 00
			03 1A 00 00 34 53 00 00
			03 1A 00 00 34 54 0F 00
			03 1A 00 00 34 72 9C 00
			03 1A 00 00 34 73 07 00
			03 1A 00 00 34 80 49 00
			03 1A 00 00 30 18 65 00
			03 1A 00 00 30 19 04 00
			03 1A 00 00 30 1A 00 00
			03 1A 00 00 30 01 01 00
			03 1A 00 00 30 14 00 00
			03 1A 00 00 30 16 08 00
			03 1A 00 00 30 09 00 00
			03 1A 00 00 30 01 00 00
			03 1A 00 00 30 01 01 00
			03 1A 00 00 30 20 13 00
			03 1A 00 00 30 21 03 00
			03 1A 00 00 30 22 00 00
			03 1A 00 00 30 18 65 00
			03 1A 00 00 30 19 04 00
			03 1A 00 00 30 1A 00 00
			03 1A 00 00 30 01 00 00
			03 1A 00 00 30 07 00 00
			03 1A 00 00 30 00 00 00
			80 00 A6 0E
			03 1A 00 00 30 02 00 00
			00 00 00 00
		];
		gain_cmd_oft = <800>;
		gain_cmd_size = <40>;
		expt_cmd_oft = <840>;
		expt_cmd_size = <64>;
	};
};

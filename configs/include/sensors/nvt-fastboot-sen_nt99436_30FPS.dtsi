&sensor {
	sen_nt99436: sen_nt99436 {
		sen_mode = <1>;
		fps = <3000>;
		expt = <10000>;
		gain = <1000>;
		mirror = <0>;
		flip = <0>;
		mclk_src = <0>;
		mclk_clk = <24000000>;
		pwdn_pin = <0xFFFFFFFF>;
		rst_pin = <0xC4>;
		rst_time = <1>;
		stable_time = <1>;
		ob = <64>;
		i2c_id = <2>;
		i2c_addr = <0x23>;
		row_time = <208>;
		pclk = <75000000>;
		hdr_en = <0>;
		data_fmt = <1>;
		mode_type = <1>;
		dft_fps = <3000>;
		frame_num = <1>;
		valid_size_w = <2688>;
		valid_size_h = <1522>;
		act_size_x = <0>;
		act_size_y = <2>;
		act_size_w = <2688>;
		act_size_h = <1520>;
		crp_size_w = <2688>;
		crp_size_h = <1520>;
		hd = <1562>;
		vd = <1600>;
		max_gain = <15500>;
		min_gain = <1000>;
		max_vd = <16383>;
		min_expt = <1>;
		cmd = [
			03 23 00 00 36 44 1F 00
			03 23 00 00 36 45 AB 00
			03 23 00 00 33 98 60 00
			03 23 00 00 32 7C 37 00
			03 23 00 00 32 52 21 00
			03 23 00 00 32 53 8B 00
			03 23 00 00 32 5E 14 00
			03 23 00 00 32 E1 03 00
			03 23 00 00 33 26 30 00
			03 23 00 00 33 28 8C 00
			03 23 00 00 33 5D 8C 00
			03 23 00 00 33 99 30 00
			03 23 00 00 36 0A 5F 00
			03 23 00 00 36 20 18 00
			03 23 00 00 36 21 04 00
			03 23 00 00 33 32 1C 00
			03 23 00 00 33 25 1C 00
			03 23 00 00 33 42 1C 00
			03 23 00 00 33 43 18 00
			03 23 00 00 33 5A 1C 00
			03 23 00 00 33 5B 26 00
			03 23 00 00 33 6A 1C 00
			03 23 00 00 33 6B 18 00
			03 23 00 00 3A 0A 07 00
			03 23 00 00 80 3F 21 00
			03 23 00 00 0B 04 01 00
			03 23 00 00 01 38 01 00
			03 23 00 00 83 3F 01 00
			03 23 00 00 0B 06 01 00
			03 23 00 00 03 50 01 00
			03 23 00 00 32 60 11 00
			03 23 00 00 32 F3 02 00
			03 23 00 00 32 CA 00 00
			03 23 00 00 32 CB C0 00
			03 23 00 00 33 6C 00 00
			03 23 00 00 33 6D 7C 00
			03 23 00 00 01 00 00 00
			03 23 00 00 01 36 18 00
			03 23 00 00 01 37 00 00
			03 23 00 00 01 14 01 00
			03 23 00 00 03 05 06 00
			03 23 00 00 03 07 96 00
			03 23 00 00 03 09 68 00
			03 23 00 00 03 0A 06 00
			03 23 00 00 03 0B 01 00
			03 23 00 00 03 0C 01 00
			03 23 00 00 03 0F B4 00
			03 23 00 00 31 31 06 00
			03 23 00 00 31 32 96 00
			03 23 00 00 30 2D 00 00
			03 23 00 00 30 28 02 00
			03 23 00 00 30 29 02 00
			03 23 00 00 03 42 06 00
			03 23 00 00 03 43 1A 00
			03 23 00 00 03 40 06 00
			03 23 00 00 03 41 40 00
			03 23 00 00 03 44 00 00
			03 23 00 00 03 45 00 00
			03 23 00 00 03 46 00 00
			03 23 00 00 03 47 00 00
			03 23 00 00 03 48 0A 00
			03 23 00 00 03 49 7F 00
			03 23 00 00 03 4A 05 00
			03 23 00 00 03 4B F1 00
			03 23 00 00 03 81 01 00
			03 23 00 00 03 83 01 00
			03 23 00 00 03 85 01 00
			03 23 00 00 03 87 01 00
			03 23 00 00 09 00 00 00
			03 23 00 00 09 01 11 00
			03 23 00 00 04 08 00 00
			03 23 00 00 04 09 00 00
			03 23 00 00 04 0A 00 00
			03 23 00 00 04 0B 00 00
			03 23 00 00 04 0C 0A 00
			03 23 00 00 04 0D 80 00
			03 23 00 00 04 0E 05 00
			03 23 00 00 04 0F F2 00
			03 23 00 00 03 4C 0A 00
			03 23 00 00 03 4D 80 00
			03 23 00 00 03 4E 05 00
			03 23 00 00 03 4F F2 00
			03 23 00 00 03 89 00 00
			03 23 00 00 03 8A 07 00
			03 23 00 00 02 80 02 00
			03 23 00 00 82 05 02 00
			03 23 00 00 82 BB 77 00
			03 23 00 00 82 B8 06 00
			03 23 00 00 82 B9 06 00
			03 23 00 00 82 BC 38 00
			03 23 00 00 82 CB 20 00
			03 23 00 00 82 BD 03 00
			03 23 00 00 82 BE 03 00
			03 23 00 00 82 BF 50 00
			03 23 00 00 82 C0 40 00
			03 23 00 00 82 C1 40 00
			03 23 00 00 82 C2 40 00
			03 23 00 00 82 C3 00 00
			03 23 00 00 82 C4 5F 00
			03 23 00 00 82 C5 0F 00
			03 23 00 00 82 C6 1F 00
			03 23 00 00 82 D3 01 00
			03 23 00 00 82 D4 E0 00
			03 23 00 00 82 D5 8E 00
			03 23 00 00 82 D6 01 00
			03 23 00 00 82 D7 90 00
			03 23 00 00 82 D8 89 00
			03 23 00 00 02 6B 02 00
			03 23 00 00 02 6C 40 00
			03 23 00 00 02 6D 02 00
			03 23 00 00 02 6E 40 00
			03 23 00 00 02 0A 02 00
			03 23 00 00 05 05 03 00
			03 23 00 00 05 06 9F 00
			03 23 00 00 05 24 00 00
			03 23 00 00 05 25 05 00
			03 23 00 00 05 26 00 00
			03 23 00 00 05 27 15 00
			03 23 00 00 05 28 00 00
			03 23 00 00 05 29 54 00
			03 23 00 00 05 2A 01 00
			03 23 00 00 05 2B 51 00
			03 23 00 00 05 2C 05 00
			03 23 00 00 05 2D 44 00
			03 23 00 00 05 6B 12 00
			03 23 00 00 05 6C 03 00
			03 23 00 00 05 20 0B 00
			03 23 00 00 05 21 01 00
			03 23 00 00 30 45 01 00
			03 23 00 00 30 2A 60 00
			03 23 00 00 02 02 06 00
			03 23 00 00 02 03 40 00
			03 23 00 00 02 07 00 00
			03 23 00 00 03 40 06 00
			03 23 00 00 03 41 40 00
			03 23 00 00 02 02 01 00
			03 23 00 00 02 03 E0 00
			03 23 00 00 01 00 01 00
			80 80 32 02
			03 23 00 00 30 2A 00 00
			00 00 00 00
		];
		gain_cmd_oft = <1056>;
		gain_cmd_size = <8>;
		expt_cmd_oft = <1064>;
		expt_cmd_size = <32>;
	};
};

&sensor {
	sen_os04c10: sen_os04c10 {
		sen_mode = <4>;
		fps = <24000>;
		expt = <4000>;
		gain = <1000>;
		mirror = <1>;
		flip = <0>;
		mclk_src = <0>;
		mclk_clk = <24000000>;
		pwdn_pin = <0xFFFFFFFF>;
		rst_pin = <0xC4>;
		rst_time = <1>;
		stable_time = <1>;
		ob = <256>;
		i2c_id = <2>;
		i2c_addr = <0x36>;
		row_time = <52>;
		pclk = <101000000>;
		hdr_en = <0>;
		data_fmt = <1>;
		mode_type = <1>;
		dft_fps = <24000>;
		frame_num = <1>;
		valid_size_w = <1284>;
		valid_size_h = <724>;
		act_size_x = <3>;
		act_size_y = <3>;
		act_size_w = <1280>;
		act_size_h = <720>;
		crp_size_w = <1280>;
		crp_size_h = <720>;
		hd = <535>;
		vd = <786>;
		max_gain = <744000>;
		min_gain = <1000>;
		max_vd = <65535>;
		min_expt = <2>;
		cmd = [
			80 80 BB 00
			03 36 00 00 01 03 01 00
			03 36 00 00 03 01 84 00
			03 36 00 00 03 03 01 00
			03 36 00 00 03 05 5B 00
			03 36 00 00 03 06 00 00
			03 36 00 00 03 07 17 00
			03 36 00 00 03 23 04 00
			03 36 00 00 03 24 01 00
			03 36 00 00 03 25 62 00
			03 36 00 00 30 12 06 00
			03 36 00 00 30 13 02 00
			03 36 00 00 30 16 32 00
			03 36 00 00 30 21 03 00
			03 36 00 00 31 06 25 00
			03 36 00 00 31 07 A1 00
			03 36 00 00 35 00 00 00
			03 36 00 00 35 01 02 00
			03 36 00 00 35 02 40 00
			03 36 00 00 35 03 88 00
			03 36 00 00 35 08 00 00
			03 36 00 00 35 09 80 00
			03 36 00 00 35 0A 04 00
			03 36 00 00 35 0B 00 00
			03 36 00 00 35 0C 00 00
			03 36 00 00 35 0D 80 00
			03 36 00 00 35 0E 04 00
			03 36 00 00 35 0F 00 00
			03 36 00 00 35 10 00 00
			03 36 00 00 35 11 00 00
			03 36 00 00 35 12 20 00
			03 36 00 00 36 24 00 00
			03 36 00 00 36 25 4C 00
			03 36 00 00 36 60 00 00
			03 36 00 00 36 66 A5 00
			03 36 00 00 36 67 A5 00
			03 36 00 00 36 6A 64 00
			03 36 00 00 36 73 0D 00
			03 36 00 00 36 72 0D 00
			03 36 00 00 36 71 0D 00
			03 36 00 00 36 70 0D 00
			03 36 00 00 36 85 00 00
			03 36 00 00 36 94 0D 00
			03 36 00 00 36 93 0D 00
			03 36 00 00 36 92 0D 00
			03 36 00 00 36 91 0D 00
			03 36 00 00 36 96 4C 00
			03 36 00 00 36 97 4C 00
			03 36 00 00 36 98 40 00
			03 36 00 00 36 99 80 00
			03 36 00 00 36 9A 18 00
			03 36 00 00 36 9B 1F 00
			03 36 00 00 36 9C 14 00
			03 36 00 00 36 9D 80 00
			03 36 00 00 36 9E 40 00
			03 36 00 00 36 9F 21 00
			03 36 00 00 36 A0 12 00
			03 36 00 00 36 A1 5D 00
			03 36 00 00 36 A2 66 00
			03 36 00 00 37 0A 00 00
			03 36 00 00 37 0E 0C 00
			03 36 00 00 37 10 00 00
			03 36 00 00 37 13 00 00
			03 36 00 00 37 25 02 00
			03 36 00 00 37 2A 03 00
			03 36 00 00 37 38 CE 00
			03 36 00 00 37 48 00 00
			03 36 00 00 37 4A 00 00
			03 36 00 00 37 4C 00 00
			03 36 00 00 37 4E 00 00
			03 36 00 00 37 56 00 00
			03 36 00 00 37 57 0E 00
			03 36 00 00 37 67 00 00
			03 36 00 00 37 71 00 00
			03 36 00 00 37 7B 20 00
			03 36 00 00 37 7C 00 00
			03 36 00 00 37 7D 0C 00
			03 36 00 00 37 81 03 00
			03 36 00 00 37 82 00 00
			03 36 00 00 37 89 14 00
			03 36 00 00 37 95 02 00
			03 36 00 00 37 9C 00 00
			03 36 00 00 37 9D 00 00
			03 36 00 00 37 B8 04 00
			03 36 00 00 37 BA 03 00
			03 36 00 00 37 BB 00 00
			03 36 00 00 37 BC 04 00
			03 36 00 00 37 BE 08 00
			03 36 00 00 37 C4 11 00
			03 36 00 00 37 C5 80 00
			03 36 00 00 37 C6 14 00
			03 36 00 00 37 C7 08 00
			03 36 00 00 37 DA 11 00
			03 36 00 00 38 1F 08 00
			03 36 00 00 38 29 03 00
			03 36 00 00 38 81 00 00
			03 36 00 00 38 88 04 00
			03 36 00 00 38 8B 00 00
			03 36 00 00 3C 80 10 00
			03 36 00 00 3C 86 00 00
			03 36 00 00 3C 8C 20 00
			03 36 00 00 3C 9F 01 00
			03 36 00 00 3D 85 1B 00
			03 36 00 00 3D 8C 71 00
			03 36 00 00 3D 8D E2 00
			03 36 00 00 3F 00 0B 00
			03 36 00 00 3F 06 04 00
			03 36 00 00 40 0A 01 00
			03 36 00 00 40 0B 50 00
			03 36 00 00 40 0E 08 00
			03 36 00 00 40 43 7E 00
			03 36 00 00 40 45 7E 00
			03 36 00 00 40 47 7E 00
			03 36 00 00 40 49 7E 00
			03 36 00 00 40 90 14 00
			03 36 00 00 40 B0 00 00
			03 36 00 00 40 B1 00 00
			03 36 00 00 40 B2 00 00
			03 36 00 00 40 B3 00 00
			03 36 00 00 40 B4 00 00
			03 36 00 00 40 B5 00 00
			03 36 00 00 40 B7 00 00
			03 36 00 00 40 B8 00 00
			03 36 00 00 40 B9 00 00
			03 36 00 00 40 BA 00 00
			03 36 00 00 43 01 00 00
			03 36 00 00 43 03 00 00
			03 36 00 00 45 02 04 00
			03 36 00 00 45 03 00 00
			03 36 00 00 45 04 06 00
			03 36 00 00 45 06 00 00
			03 36 00 00 45 07 64 00
			03 36 00 00 48 03 00 00
			03 36 00 00 48 0C 32 00
			03 36 00 00 48 0E 00 00
			03 36 00 00 48 13 00 00
			03 36 00 00 48 19 70 00
			03 36 00 00 48 1F 30 00
			03 36 00 00 48 23 3F 00
			03 36 00 00 48 25 30 00
			03 36 00 00 48 33 10 00
			03 36 00 00 48 4B 07 00
			03 36 00 00 48 8B 00 00
			03 36 00 00 4D 00 04 00
			03 36 00 00 4D 01 AD 00
			03 36 00 00 4D 02 BC 00
			03 36 00 00 4D 03 A1 00
			03 36 00 00 4D 04 1F 00
			03 36 00 00 4D 05 4C 00
			03 36 00 00 4D 0B 01 00
			03 36 00 00 4E 00 2A 00
			03 36 00 00 4E 0D 00 00
			03 36 00 00 50 01 09 00
			03 36 00 00 50 04 00 00
			03 36 00 00 50 80 04 00
			03 36 00 00 50 36 00 00
			03 36 00 00 51 80 70 00
			03 36 00 00 51 81 10 00
			03 36 00 00 52 0A 03 00
			03 36 00 00 52 0B 06 00
			03 36 00 00 52 0C 0C 00
			03 36 00 00 58 0B 0F 00
			03 36 00 00 58 0D 00 00
			03 36 00 00 58 0F 00 00
			03 36 00 00 58 20 00 00
			03 36 00 00 58 21 00 00
			03 36 00 00 30 1C F8 00
			03 36 00 00 30 1E B4 00
			03 36 00 00 30 1F D0 00
			03 36 00 00 30 22 01 00
			03 36 00 00 31 09 E7 00
			03 36 00 00 36 00 00 00
			03 36 00 00 36 10 65 00
			03 36 00 00 36 11 85 00
			03 36 00 00 36 13 3A 00
			03 36 00 00 36 15 60 00
			03 36 00 00 36 21 90 00
			03 36 00 00 36 20 01 00
			03 36 00 00 36 29 00 00
			03 36 00 00 36 61 04 00
			03 36 00 00 36 64 70 00
			03 36 00 00 36 65 00 00
			03 36 00 00 36 81 A6 00
			03 36 00 00 36 82 53 00
			03 36 00 00 36 83 2A 00
			03 36 00 00 36 84 15 00
			03 36 00 00 37 00 2A 00
			03 36 00 00 37 01 12 00
			03 36 00 00 37 03 28 00
			03 36 00 00 37 04 0E 00
			03 36 00 00 37 06 4A 00
			03 36 00 00 37 09 4A 00
			03 36 00 00 37 0B A2 00
			03 36 00 00 37 0C 01 00
			03 36 00 00 37 0F 04 00
			03 36 00 00 37 14 28 00
			03 36 00 00 37 16 24 00
			03 36 00 00 37 19 11 00
			03 36 00 00 37 1A 1E 00
			03 36 00 00 37 20 00 00
			03 36 00 00 37 24 13 00
			03 36 00 00 37 3F A0 00
			03 36 00 00 37 41 4A 00
			03 36 00 00 37 43 4A 00
			03 36 00 00 37 45 4A 00
			03 36 00 00 37 47 4A 00
			03 36 00 00 37 49 A2 00
			03 36 00 00 37 4B A2 00
			03 36 00 00 37 4D A2 00
			03 36 00 00 37 4F A2 00
			03 36 00 00 37 55 10 00
			03 36 00 00 37 6C 00 00
			03 36 00 00 37 8D 30 00
			03 36 00 00 37 90 4A 00
			03 36 00 00 37 91 A2 00
			03 36 00 00 37 98 C0 00
			03 36 00 00 37 9E 00 00
			03 36 00 00 37 9F 04 00
			03 36 00 00 37 A1 10 00
			03 36 00 00 37 A2 1E 00
			03 36 00 00 37 A8 10 00
			03 36 00 00 37 A9 1E 00
			03 36 00 00 37 AC A0 00
			03 36 00 00 37 B9 01 00
			03 36 00 00 37 BD 01 00
			03 36 00 00 37 BF 26 00
			03 36 00 00 37 C0 11 00
			03 36 00 00 37 C2 14 00
			03 36 00 00 37 CD 19 00
			03 36 00 00 37 E0 08 00
			03 36 00 00 37 E6 04 00
			03 36 00 00 37 E5 02 00
			03 36 00 00 37 E1 0C 00
			03 36 00 00 37 37 04 00
			03 36 00 00 37 D8 02 00
			03 36 00 00 37 E2 10 00
			03 36 00 00 37 39 10 00
			03 36 00 00 36 62 08 00
			03 36 00 00 37 E4 20 00
			03 36 00 00 37 E3 08 00
			03 36 00 00 37 D9 04 00
			03 36 00 00 40 40 00 00
			03 36 00 00 40 41 03 00
			03 36 00 00 40 08 01 00
			03 36 00 00 40 09 06 00
			03 36 00 00 38 00 00 00
			03 36 00 00 38 01 38 00
			03 36 00 00 38 02 00 00
			03 36 00 00 38 03 20 00
			03 36 00 00 38 04 0A 00
			03 36 00 00 38 05 57 00
			03 36 00 00 38 06 05 00
			03 36 00 00 38 07 DF 00
			03 36 00 00 38 08 05 00
			03 36 00 00 38 09 04 00
			03 36 00 00 38 0A 02 00
			03 36 00 00 38 0B D4 00
			03 36 00 00 38 0C 02 00
			03 36 00 00 38 0D 17 00
			03 36 00 00 38 0E 03 00
			03 36 00 00 38 0F 12 00
			03 36 00 00 38 11 06 00
			03 36 00 00 38 13 06 00
			03 36 00 00 38 14 03 00
			03 36 00 00 38 15 01 00
			03 36 00 00 38 16 03 00
			03 36 00 00 38 17 01 00
			03 36 00 00 38 20 8B 00
			03 36 00 00 38 21 01 00
			03 36 00 00 38 80 25 00
			03 36 00 00 38 82 20 00
			03 36 00 00 3C 91 0B 00
			03 36 00 00 3C 94 45 00
			03 36 00 00 3C AD 00 00
			03 36 00 00 3C AE 00 00
			03 36 00 00 40 00 F3 00
			03 36 00 00 40 01 60 00
			03 36 00 00 40 03 40 00
			03 36 00 00 43 00 FF 00
			03 36 00 00 43 02 0F 00
			03 36 00 00 43 05 83 00
			03 36 00 00 45 05 A4 00
			03 36 00 00 48 09 1E 00
			03 36 00 00 48 0A 04 00
			03 36 00 00 48 37 0A 00
			03 36 00 00 4C 00 08 00
			03 36 00 00 4C 01 08 00
			03 36 00 00 4C 04 00 00
			03 36 00 00 4C 05 00 00
			03 36 00 00 50 00 F9 00
			03 36 00 00 38 0E 03 00
			03 36 00 00 38 0F 12 00
			03 36 00 00 32 0D 00 00
			03 36 00 00 32 08 00 00
			03 36 00 00 35 08 00 00
			03 36 00 00 35 09 80 00
			03 36 00 00 35 0A 04 00
			03 36 00 00 35 0B 00 00
			03 36 00 00 37 98 C0 00
			03 36 00 00 35 03 88 00
			03 36 00 00 32 08 10 00
			03 36 00 00 32 0D 00 00
			03 36 00 00 32 08 A0 00
			03 36 00 00 38 0E 03 00
			03 36 00 00 38 0F 12 00
			03 36 00 00 35 01 03 00
			03 36 00 00 35 02 01 00
			03 36 00 00 51 02 04 00
			03 36 00 00 51 03 00 00
			03 36 00 00 51 42 04 00
			03 36 00 00 51 43 00 00
			03 36 00 00 38 20 8B 00
			03 36 00 00 37 16 24 00
			03 36 00 00 01 00 01 00
			00 00 00 00
		];
		gain_cmd_oft = <2332>;
		gain_cmd_size = <88>;
		expt_cmd_oft = <2420>;
		expt_cmd_size = <64>;
	};
};

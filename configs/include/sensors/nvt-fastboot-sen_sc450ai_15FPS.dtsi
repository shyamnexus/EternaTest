&sensor {
	sen_sc450ai: sen_sc450ai {
		sen_mode = <6>;
		fps = <1500>;
		expt = <10000>;
		gain = <1000>;
		mirror = <1>;
		flip = <0>;
		mclk_src = <0>;
		mclk_clk = <27000000>;
		pwdn_pin = <0xFFFFFFFF>;
		rst_pin = <0xC4>;
		rst_time = <1>;
		stable_time = <1>;
		ob = <260>;
		i2c_id = <2>;
		i2c_addr = <0x30>;
		row_time = <106>;
		pclk = <140400000>;
		hdr_en = <0>;
		data_fmt = <1>;
		mode_type = <1>;
		dft_fps = <1500>;
		frame_num = <1>;
		valid_size_w = <2688>;
		valid_size_h = <1524>;
		act_size_x = <0>;
		act_size_y = <2>;
		act_size_w = <2688>;
		act_size_h = <1520>;
		crp_size_w = <2688>;
		crp_size_h = <1520>;
		hd = <750>;
		vd = <3120>;
		max_gain = <960802>;
		min_gain = <1000>;
		max_vd = <65535>;
		min_expt = <1>;
		cmd = [
			03 30 00 00 01 03 01 00
			03 30 00 00 01 00 00 00
			03 30 00 00 36 E9 80 00
			03 30 00 00 36 F9 80 00
			03 30 00 00 30 1C 78 00
			03 30 00 00 30 1F 72 00
			03 30 00 00 30 2E 00 00
			03 30 00 00 32 00 00 00
			03 30 00 00 32 01 00 00
			03 30 00 00 32 02 00 00
			03 30 00 00 32 03 02 00
			03 30 00 00 32 04 0A 00
			03 30 00 00 32 05 8F 00
			03 30 00 00 32 06 05 00
			03 30 00 00 32 07 FD 00
			03 30 00 00 32 08 0A 00
			03 30 00 00 32 09 80 00
			03 30 00 00 32 0A 05 00
			03 30 00 00 32 0B F4 00
			03 30 00 00 32 0C 02 00
			03 30 00 00 32 0D EE 00
			03 30 00 00 32 0E 0C 00
			03 30 00 00 32 0F 30 00
			03 30 00 00 32 10 00 00
			03 30 00 00 32 11 09 00
			03 30 00 00 32 12 00 00
			03 30 00 00 32 13 05 00
			03 30 00 00 32 14 11 00
			03 30 00 00 32 15 11 00
			03 30 00 00 32 20 00 00
			03 30 00 00 32 23 C0 00
			03 30 00 00 32 53 10 00
			03 30 00 00 32 5F 44 00
			03 30 00 00 32 74 09 00
			03 30 00 00 32 80 01 00
			03 30 00 00 33 01 07 00
			03 30 00 00 33 06 20 00
			03 30 00 00 33 08 08 00
			03 30 00 00 33 0B 58 00
			03 30 00 00 33 0E 18 00
			03 30 00 00 33 15 00 00
			03 30 00 00 33 5D 60 00
			03 30 00 00 33 64 56 00
			03 30 00 00 33 8F 80 00
			03 30 00 00 33 90 08 00
			03 30 00 00 33 91 18 00
			03 30 00 00 33 92 38 00
			03 30 00 00 33 93 07 00
			03 30 00 00 33 94 10 00
			03 30 00 00 33 95 18 00
			03 30 00 00 33 96 08 00
			03 30 00 00 33 97 18 00
			03 30 00 00 33 98 38 00
			03 30 00 00 33 99 10 00
			03 30 00 00 33 9A 13 00
			03 30 00 00 33 9B 15 00
			03 30 00 00 33 9C 18 00
			03 30 00 00 33 AF 18 00
			03 30 00 00 36 0F 13 00
			03 30 00 00 36 21 EC 00
			03 30 00 00 36 22 00 00
			03 30 00 00 36 25 0B 00
			03 30 00 00 36 27 20 00
			03 30 00 00 36 30 90 00
			03 30 00 00 36 33 56 00
			03 30 00 00 36 37 1D 00
			03 30 00 00 36 38 12 00
			03 30 00 00 36 3C 0F 00
			03 30 00 00 36 3D 0F 00
			03 30 00 00 36 3E 08 00
			03 30 00 00 36 70 4A 00
			03 30 00 00 36 71 E0 00
			03 30 00 00 36 72 E0 00
			03 30 00 00 36 73 E0 00
			03 30 00 00 36 74 C0 00
			03 30 00 00 36 75 87 00
			03 30 00 00 36 76 8C 00
			03 30 00 00 36 7A 48 00
			03 30 00 00 36 7B 58 00
			03 30 00 00 36 7C 48 00
			03 30 00 00 36 7D 58 00
			03 30 00 00 36 90 22 00
			03 30 00 00 36 91 33 00
			03 30 00 00 36 92 44 00
			03 30 00 00 36 99 03 00
			03 30 00 00 36 9A 0F 00
			03 30 00 00 36 9B 1F 00
			03 30 00 00 36 9C 40 00
			03 30 00 00 36 9D 78 00
			03 30 00 00 36 A2 48 00
			03 30 00 00 36 A3 78 00
			03 30 00 00 36 B0 53 00
			03 30 00 00 36 B1 74 00
			03 30 00 00 36 B2 34 00
			03 30 00 00 36 B3 40 00
			03 30 00 00 36 B4 78 00
			03 30 00 00 36 B7 A0 00
			03 30 00 00 36 B8 A0 00
			03 30 00 00 36 B9 20 00
			03 30 00 00 36 BD 40 00
			03 30 00 00 36 BE 48 00
			03 30 00 00 36 D0 20 00
			03 30 00 00 36 E0 08 00
			03 30 00 00 36 E1 08 00
			03 30 00 00 36 E2 12 00
			03 30 00 00 36 E3 48 00
			03 30 00 00 36 E4 78 00
			03 30 00 00 36 EC 53 00
			03 30 00 00 36 FC 00 00
			03 30 00 00 39 07 00 00
			03 30 00 00 39 08 41 00
			03 30 00 00 39 1E F1 00
			03 30 00 00 39 1F 11 00
			03 30 00 00 39 33 82 00
			03 30 00 00 39 34 30 00
			03 30 00 00 39 35 02 00
			03 30 00 00 39 36 C7 00
			03 30 00 00 39 37 76 00
			03 30 00 00 39 38 76 00
			03 30 00 00 39 39 00 00
			03 30 00 00 39 3A 28 00
			03 30 00 00 39 3B 00 00
			03 30 00 00 39 3C 23 00
			03 30 00 00 3E 00 01 00
			03 30 00 00 3E 01 85 00
			03 30 00 00 3E 02 80 00
			03 30 00 00 3E 03 0B 00
			03 30 00 00 3E 08 03 00
			03 30 00 00 3E 1B 2A 00
			03 30 00 00 44 0E 02 00
			03 30 00 00 45 09 20 00
			03 30 00 00 48 37 2C 00
			03 30 00 00 50 00 0E 00
			03 30 00 00 50 01 44 00
			03 30 00 00 57 80 76 00
			03 30 00 00 57 84 08 00
			03 30 00 00 57 85 04 00
			03 30 00 00 57 87 0A 00
			03 30 00 00 57 88 0A 00
			03 30 00 00 57 89 0A 00
			03 30 00 00 57 8A 0A 00
			03 30 00 00 57 8B 0A 00
			03 30 00 00 57 8C 0A 00
			03 30 00 00 57 8D 40 00
			03 30 00 00 57 90 08 00
			03 30 00 00 57 91 04 00
			03 30 00 00 57 92 04 00
			03 30 00 00 57 93 08 00
			03 30 00 00 57 94 04 00
			03 30 00 00 57 95 04 00
			03 30 00 00 57 99 46 00
			03 30 00 00 57 9A 77 00
			03 30 00 00 57 A1 04 00
			03 30 00 00 57 A8 D0 00
			03 30 00 00 57 AA 2A 00
			03 30 00 00 57 AB 7F 00
			03 30 00 00 57 AC 00 00
			03 30 00 00 57 AD 00 00
			03 30 00 00 59 E0 FE 00
			03 30 00 00 59 E1 40 00
			03 30 00 00 59 E2 3F 00
			03 30 00 00 59 E3 38 00
			03 30 00 00 59 E4 30 00
			03 30 00 00 59 E5 3F 00
			03 30 00 00 59 E6 38 00
			03 30 00 00 59 E7 30 00
			03 30 00 00 59 E8 3F 00
			03 30 00 00 59 E9 3C 00
			03 30 00 00 59 EA 38 00
			03 30 00 00 59 EB 3F 00
			03 30 00 00 59 EC 3C 00
			03 30 00 00 59 ED 38 00
			03 30 00 00 59 EE FE 00
			03 30 00 00 59 EF 40 00
			03 30 00 00 59 F4 3F 00
			03 30 00 00 59 F5 38 00
			03 30 00 00 59 F6 30 00
			03 30 00 00 59 F7 3F 00
			03 30 00 00 59 F8 38 00
			03 30 00 00 59 F9 30 00
			03 30 00 00 59 FA 3F 00
			03 30 00 00 59 FB 3C 00
			03 30 00 00 59 FC 38 00
			03 30 00 00 59 FD 3F 00
			03 30 00 00 59 FE 3C 00
			03 30 00 00 59 FF 38 00
			03 30 00 00 36 E9 44 00
			03 30 00 00 36 F9 20 00
			03 30 00 00 32 0E 0C 00
			03 30 00 00 32 0F 30 00
			03 30 00 00 3E 08 03 00
			03 30 00 00 3E 09 40 00
			03 30 00 00 3E 06 00 00
			03 30 00 00 3E 07 80 00
			03 30 00 00 32 0E 0C 00
			03 30 00 00 32 0F 30 00
			03 30 00 00 3E 00 00 00
			03 30 00 00 3E 01 3A 00
			03 30 00 00 3E 02 F0 00
			03 30 00 00 32 21 06 00
			03 30 00 00 01 00 01 00
			00 00 00 00
		];
		gain_cmd_oft = <1520>;
		gain_cmd_size = <32>;
		expt_cmd_oft = <1552>;
		expt_cmd_size = <40>;
	};
};

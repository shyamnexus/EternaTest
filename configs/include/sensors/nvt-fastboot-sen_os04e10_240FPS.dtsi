&sensor {
	sen_os04e10: sen_os04e10 {
		sen_mode = <5>;
		fps = <24000>;
		expt = <4000>;
		gain = <1000>;
		mirror = <1>;
		flip = <0>;
		mclk_src = <0>;
		mclk_clk = <24000000>;
		pwdn_pin = <0xFFFFFFFF>;
		rst_pin = <0xC4>;
		rst_time = <1>;
		stable_time = <1>;
		ob = <256>;
		i2c_id = <2>;
		i2c_addr = <0x36>;
		row_time = <38>;
		pclk = <105000000>;
		hdr_en = <0>;
		data_fmt = <1>;
		mode_type = <1>;
		dft_fps = <24000>;
		frame_num = <1>;
		valid_size_w = <512>;
		valid_size_h = <514>;
		act_size_x = <0>;
		act_size_y = <2>;
		act_size_w = <512>;
		act_size_h = <512>;
		crp_size_w = <512>;
		crp_size_h = <512>;
		hd = <404>;
		vd = <1080>;
		max_gain = <743535>;
		min_gain = <1000>;
		max_vd = <16777215>;
		min_expt = <2>;
		cmd = [
			03 36 00 00 01 00 00 00
			03 36 00 00 01 03 01 00
			03 36 00 00 03 01 44 00
			03 36 00 00 03 03 02 00
			03 36 00 00 03 04 00 00
			03 36 00 00 03 05 4B 00
			03 36 00 00 03 06 00 00
			03 36 00 00 03 25 3B 00
			03 36 00 00 03 27 04 00
			03 36 00 00 03 28 05 00
			03 36 00 00 30 02 21 00
			03 36 00 00 30 16 32 00
			03 36 00 00 30 1B F0 00
			03 36 00 00 30 1E B4 00
			03 36 00 00 30 1F D0 00
			03 36 00 00 30 21 03 00
			03 36 00 00 30 22 01 00
			03 36 00 00 31 07 A1 00
			03 36 00 00 31 08 7D 00
			03 36 00 00 31 09 FC 00
			03 36 00 00 35 00 00 00
			03 36 00 00 35 01 02 00
			03 36 00 00 35 02 B0 00
			03 36 00 00 35 03 88 00
			03 36 00 00 35 08 01 00
			03 36 00 00 35 09 00 00
			03 36 00 00 35 0A 04 00
			03 36 00 00 35 0B 00 00
			03 36 00 00 35 0C 04 00
			03 36 00 00 35 0D 00 00
			03 36 00 00 35 0E 04 00
			03 36 00 00 35 0F 00 00
			03 36 00 00 35 10 00 00
			03 36 00 00 35 11 00 00
			03 36 00 00 35 12 20 00
			03 36 00 00 36 00 4C 00
			03 36 00 00 36 01 08 00
			03 36 00 00 36 10 87 00
			03 36 00 00 36 11 24 00
			03 36 00 00 36 14 4C 00
			03 36 00 00 36 20 01 00
			03 36 00 00 36 21 04 00
			03 36 00 00 36 32 80 00
			03 36 00 00 36 33 00 00
			03 36 00 00 36 60 00 00
			03 36 00 00 36 62 08 00
			03 36 00 00 36 64 70 00
			03 36 00 00 36 65 00 00
			03 36 00 00 36 66 00 00
			03 36 00 00 36 67 00 00
			03 36 00 00 36 6A 14 00
			03 36 00 00 36 70 0B 00
			03 36 00 00 36 71 0B 00
			03 36 00 00 36 72 0B 00
			03 36 00 00 36 73 0B 00
			03 36 00 00 36 74 00 00
			03 36 00 00 36 78 2B 00
			03 36 00 00 36 79 43 00
			03 36 00 00 36 81 FF 00
			03 36 00 00 36 82 86 00
			03 36 00 00 36 83 44 00
			03 36 00 00 36 84 24 00
			03 36 00 00 36 85 00 00
			03 36 00 00 36 8A 00 00
			03 36 00 00 36 8D 2B 00
			03 36 00 00 36 8E 6B 00
			03 36 00 00 36 90 00 00
			03 36 00 00 36 91 0B 00
			03 36 00 00 36 92 0B 00
			03 36 00 00 36 93 0B 00
			03 36 00 00 36 94 0B 00
			03 36 00 00 36 99 03 00
			03 36 00 00 36 9D 68 00
			03 36 00 00 36 9E 34 00
			03 36 00 00 36 9F 1B 00
			03 36 00 00 36 A0 0F 00
			03 36 00 00 36 A1 77 00
			03 36 00 00 36 A2 00 00
			03 36 00 00 36 A3 02 00
			03 36 00 00 36 A4 02 00
			03 36 00 00 36 B0 30 00
			03 36 00 00 36 B1 F0 00
			03 36 00 00 36 B2 00 00
			03 36 00 00 36 B3 00 00
			03 36 00 00 36 B4 00 00
			03 36 00 00 36 B5 00 00
			03 36 00 00 36 B6 00 00
			03 36 00 00 36 B7 00 00
			03 36 00 00 36 B8 00 00
			03 36 00 00 36 B9 00 00
			03 36 00 00 36 BA 00 00
			03 36 00 00 36 BB 00 00
			03 36 00 00 36 BC 00 00
			03 36 00 00 36 BD 00 00
			03 36 00 00 36 BE 00 00
			03 36 00 00 36 BF 00 00
			03 36 00 00 36 C0 1F 00
			03 36 00 00 36 C1 00 00
			03 36 00 00 36 C2 00 00
			03 36 00 00 36 C3 00 00
			03 36 00 00 36 C4 00 00
			03 36 00 00 36 C5 00 00
			03 36 00 00 36 C6 00 00
			03 36 00 00 36 C7 00 00
			03 36 00 00 36 C8 00 00
			03 36 00 00 36 C9 00 00
			03 36 00 00 36 CA 0E 00
			03 36 00 00 36 CB 0E 00
			03 36 00 00 36 CC 0E 00
			03 36 00 00 36 CD 0E 00
			03 36 00 00 36 CE 0C 00
			03 36 00 00 36 CF 0C 00
			03 36 00 00 36 D0 0C 00
			03 36 00 00 36 D1 0C 00
			03 36 00 00 36 D2 00 00
			03 36 00 00 36 D3 08 00
			03 36 00 00 36 D4 10 00
			03 36 00 00 36 D5 10 00
			03 36 00 00 36 D6 00 00
			03 36 00 00 36 D7 08 00
			03 36 00 00 36 D8 10 00
			03 36 00 00 36 D9 10 00
			03 36 00 00 37 04 05 00
			03 36 00 00 37 05 00 00
			03 36 00 00 37 06 2B 00
			03 36 00 00 37 09 49 00
			03 36 00 00 37 0A 00 00
			03 36 00 00 37 0B 60 00
			03 36 00 00 37 0E 0C 00
			03 36 00 00 37 0F 1C 00
			03 36 00 00 37 10 00 00
			03 36 00 00 37 13 00 00
			03 36 00 00 37 14 28 00
			03 36 00 00 37 16 24 00
			03 36 00 00 37 1A 1E 00
			03 36 00 00 37 24 0D 00
			03 36 00 00 37 25 B2 00
			03 36 00 00 37 2B 54 00
			03 36 00 00 37 39 10 00
			03 36 00 00 37 3F A0 00
			03 36 00 00 37 40 2B 00
			03 36 00 00 37 41 2B 00
			03 36 00 00 37 42 2B 00
			03 36 00 00 37 43 2B 00
			03 36 00 00 37 44 60 00
			03 36 00 00 37 45 60 00
			03 36 00 00 37 46 60 00
			03 36 00 00 37 47 60 00
			03 36 00 00 37 48 00 00
			03 36 00 00 37 49 00 00
			03 36 00 00 37 4A 00 00
			03 36 00 00 37 4B 00 00
			03 36 00 00 37 4C 00 00
			03 36 00 00 37 4D 00 00
			03 36 00 00 37 4E 00 00
			03 36 00 00 37 4F 00 00
			03 36 00 00 37 56 00 00
			03 36 00 00 37 57 0E 00
			03 36 00 00 37 60 11 00
			03 36 00 00 37 67 08 00
			03 36 00 00 37 73 01 00
			03 36 00 00 37 74 02 00
			03 36 00 00 37 75 12 00
			03 36 00 00 37 76 02 00
			03 36 00 00 37 7B 40 00
			03 36 00 00 37 7C 00 00
			03 36 00 00 37 7D 0C 00
			03 36 00 00 37 82 02 00
			03 36 00 00 37 87 24 00
			03 36 00 00 37 95 24 00
			03 36 00 00 37 96 01 00
			03 36 00 00 37 98 40 00
			03 36 00 00 37 9C 00 00
			03 36 00 00 37 9D 00 00
			03 36 00 00 37 9E 00 00
			03 36 00 00 37 9F 01 00
			03 36 00 00 37 A1 10 00
			03 36 00 00 37 A6 77 00
			03 36 00 00 37 AC A0 00
			03 36 00 00 37 BB 02 00
			03 36 00 00 37 BE 0A 00
			03 36 00 00 37 BF 0A 00
			03 36 00 00 37 C2 2C 00
			03 36 00 00 37 C4 11 00
			03 36 00 00 37 C5 80 00
			03 36 00 00 37 C6 14 00
			03 36 00 00 37 C7 08 00
			03 36 00 00 37 C8 42 00
			03 36 00 00 37 CD 17 00
			03 36 00 00 37 CE 04 00
			03 36 00 00 37 D9 04 00
			03 36 00 00 37 DC 01 00
			03 36 00 00 37 E0 30 00
			03 36 00 00 37 E1 10 00
			03 36 00 00 37 E2 14 00
			03 36 00 00 37 E4 28 00
			03 36 00 00 37 EF 00 00
			03 36 00 00 37 F4 00 00
			03 36 00 00 37 F5 00 00
			03 36 00 00 37 F6 00 00
			03 36 00 00 37 F7 00 00
			03 36 00 00 38 00 00 00
			03 36 00 00 38 01 00 00
			03 36 00 00 38 02 00 00
			03 36 00 00 38 03 00 00
			03 36 00 00 38 04 08 00
			03 36 00 00 38 05 0F 00
			03 36 00 00 38 06 08 00
			03 36 00 00 38 07 0F 00
			03 36 00 00 38 08 02 00
			03 36 00 00 38 09 00 00
			03 36 00 00 38 0A 02 00
			03 36 00 00 38 0B 02 00
			03 36 00 00 38 0C 01 00
			03 36 00 00 38 0D 94 00
			03 36 00 00 38 0E 04 00
			03 36 00 00 38 0F 38 00
			03 36 00 00 38 10 00 00
			03 36 00 00 38 11 01 00
			03 36 00 00 38 12 00 00
			03 36 00 00 38 13 01 00
			03 36 00 00 38 14 07 00
			03 36 00 00 38 15 01 00
			03 36 00 00 38 16 07 00
			03 36 00 00 38 17 01 00
			03 36 00 00 38 18 00 00
			03 36 00 00 38 19 00 00
			03 36 00 00 38 1A 00 00
			03 36 00 00 38 1B 01 00
			03 36 00 00 38 20 8C 00
			03 36 00 00 38 21 01 00
			03 36 00 00 38 22 04 00
			03 36 00 00 38 23 08 00
			03 36 00 00 38 24 00 00
			03 36 00 00 38 25 20 00
			03 36 00 00 38 26 00 00
			03 36 00 00 38 27 08 00
			03 36 00 00 38 29 03 00
			03 36 00 00 38 2A 00 00
			03 36 00 00 38 2B 00 00
			03 36 00 00 38 32 00 00
			03 36 00 00 38 38 00 00
			03 36 00 00 38 39 00 00
			03 36 00 00 38 3A 00 00
			03 36 00 00 38 3B 00 00
			03 36 00 00 38 3D 01 00
			03 36 00 00 38 3E 00 00
			03 36 00 00 38 3F 00 00
			03 36 00 00 38 43 00 00
			03 36 00 00 38 48 08 00
			03 36 00 00 38 49 00 00
			03 36 00 00 38 4A 08 00
			03 36 00 00 38 4B 00 00
			03 36 00 00 38 4C 00 00
			03 36 00 00 38 4D 08 00
			03 36 00 00 38 4E 00 00
			03 36 00 00 38 4F 08 00
			03 36 00 00 38 80 16 00
			03 36 00 00 38 81 00 00
			03 36 00 00 38 82 08 00
			03 36 00 00 38 8A 03 00
			03 36 00 00 38 9A 00 00
			03 36 00 00 38 9B 00 00
			03 36 00 00 38 9C 00 00
			03 36 00 00 38 A2 02 00
			03 36 00 00 38 A3 02 00
			03 36 00 00 38 A4 02 00
			03 36 00 00 38 A5 02 00
			03 36 00 00 38 A7 04 00
			03 36 00 00 38 AE 1E 00
			03 36 00 00 38 B8 02 00
			03 36 00 00 38 C3 06 00
			03 36 00 00 3C 80 3F 00
			03 36 00 00 3C 86 01 00
			03 36 00 00 3C 87 02 00
			03 36 00 00 3C A0 01 00
			03 36 00 00 3C A2 0C 00
			03 36 00 00 3D 8C 71 00
			03 36 00 00 3D 8D E2 00
			03 36 00 00 3F 00 CB 00
			03 36 00 00 3F 04 04 00
			03 36 00 00 3F 07 04 00
			03 36 00 00 3F 09 50 00
			03 36 00 00 3F 9E 07 00
			03 36 00 00 3F 9F 04 00
			03 36 00 00 40 00 F3 00
			03 36 00 00 40 02 00 00
			03 36 00 00 40 03 40 00
			03 36 00 00 40 08 00 00
			03 36 00 00 40 09 05 00
			03 36 00 00 40 0A 01 00
			03 36 00 00 40 0B 78 00
			03 36 00 00 40 0F 89 00
			03 36 00 00 40 40 00 00
			03 36 00 00 40 41 03 00
			03 36 00 00 40 90 14 00
			03 36 00 00 40 B0 00 00
			03 36 00 00 40 B1 00 00
			03 36 00 00 40 B2 00 00
			03 36 00 00 40 B3 00 00
			03 36 00 00 40 B4 00 00
			03 36 00 00 40 B5 00 00
			03 36 00 00 40 B7 00 00
			03 36 00 00 40 B8 00 00
			03 36 00 00 40 B9 00 00
			03 36 00 00 40 BA 00 00
			03 36 00 00 43 00 FF 00
			03 36 00 00 43 01 00 00
			03 36 00 00 43 02 0F 00
			03 36 00 00 43 03 01 00
			03 36 00 00 43 04 01 00
			03 36 00 00 43 05 83 00
			03 36 00 00 43 06 21 00
			03 36 00 00 43 0D 00 00
			03 36 00 00 45 01 00 00
			03 36 00 00 45 05 E4 00
			03 36 00 00 45 06 00 00
			03 36 00 00 45 07 60 00
			03 36 00 00 45 08 00 00
			03 36 00 00 46 00 00 00
			03 36 00 00 46 01 10 00
			03 36 00 00 46 03 03 00
			03 36 00 00 48 00 64 00
			03 36 00 00 48 03 00 00
			03 36 00 00 48 09 8E 00
			03 36 00 00 48 0E 00 00
			03 36 00 00 48 13 00 00
			03 36 00 00 48 14 2A 00
			03 36 00 00 48 1B 3C 00
			03 36 00 00 48 1F 26 00
			03 36 00 00 48 25 32 00
			03 36 00 00 48 29 64 00
			03 36 00 00 48 37 11 00
			03 36 00 00 48 4B 07 00
			03 36 00 00 48 83 36 00
			03 36 00 00 48 85 03 00
			03 36 00 00 48 8B 00 00
			03 36 00 00 4D 00 04 00
			03 36 00 00 4D 01 99 00
			03 36 00 00 4D 02 BD 00
			03 36 00 00 4D 03 AC 00
			03 36 00 00 4D 04 F2 00
			03 36 00 00 4D 05 54 00
			03 36 00 00 4E 00 2A 00
			03 36 00 00 4E 0D 00 00
			03 36 00 00 50 00 BB 00
			03 36 00 00 50 01 09 00
			03 36 00 00 50 04 00 00
			03 36 00 00 50 05 0E 00
			03 36 00 00 50 36 00 00
			03 36 00 00 50 80 04 00
			03 36 00 00 50 82 00 00
			03 36 00 00 51 80 70 00
			03 36 00 00 51 81 10 00
			03 36 00 00 51 82 71 00
			03 36 00 00 51 83 DF 00
			03 36 00 00 51 84 02 00
			03 36 00 00 51 85 6C 00
			03 36 00 00 51 89 48 00
			03 36 00 00 53 24 09 00
			03 36 00 00 53 25 11 00
			03 36 00 00 53 26 1F 00
			03 36 00 00 53 27 3B 00
			03 36 00 00 53 28 49 00
			03 36 00 00 53 29 61 00
			03 36 00 00 53 2A 9C 00
			03 36 00 00 53 2B C9 00
			03 36 00 00 53 35 04 00
			03 36 00 00 53 36 00 00
			03 36 00 00 53 37 04 00
			03 36 00 00 53 38 00 00
			03 36 00 00 53 39 0B 00
			03 36 00 00 53 3A 00 00
			03 36 00 00 53 A4 09 00
			03 36 00 00 53 A5 11 00
			03 36 00 00 53 A6 1F 00
			03 36 00 00 53 A7 3B 00
			03 36 00 00 53 A8 49 00
			03 36 00 00 53 A9 61 00
			03 36 00 00 53 AA 9C 00
			03 36 00 00 53 AB C9 00
			03 36 00 00 53 B5 04 00
			03 36 00 00 53 B6 00 00
			03 36 00 00 53 B7 04 00
			03 36 00 00 53 B8 00 00
			03 36 00 00 53 B9 0B 00
			03 36 00 00 53 BA 00 00
			03 36 00 00 58 0B 03 00
			03 36 00 00 58 0D 00 00
			03 36 00 00 58 0F 00 00
			03 36 00 00 58 20 00 00
			03 36 00 00 58 21 00 00
			03 36 00 00 58 88 01 00
			03 36 00 00 38 22 14 00
			03 36 00 00 3C 88 09 00
			03 36 00 00 1A 0E 04 00
			03 36 00 00 1A 0F 38 00
			03 36 00 00 32 0D 00 00
			03 36 00 00 32 08 00 00
			03 36 00 00 35 08 00 00
			03 36 00 00 35 09 80 00
			03 36 00 00 35 0A 04 00
			03 36 00 00 35 0B 00 00
			03 36 00 00 36 81 68 00
			03 36 00 00 36 82 34 00
			03 36 00 00 36 83 1B 00
			03 36 00 00 36 84 0F 00
			03 36 00 00 36 9D 68 00
			03 36 00 00 36 9E 34 00
			03 36 00 00 36 9F 1B 00
			03 36 00 00 36 A0 0F 00
			03 36 00 00 36 BC 00 00
			03 36 00 00 36 C0 00 00
			03 36 00 00 36 CA 0E 00
			03 36 00 00 36 CB 0E 00
			03 36 00 00 36 CC 0E 00
			03 36 00 00 36 CD 0E 00
			03 36 00 00 36 CE 0E 00
			03 36 00 00 36 CF 0E 00
			03 36 00 00 36 D0 0E 00
			03 36 00 00 36 D1 0E 00
			03 36 00 00 37 0E 00 00
			03 36 00 00 37 0F 00 00
			03 36 00 00 37 13 01 00
			03 36 00 00 37 9C 00 00
			03 36 00 00 37 9D 00 00
			03 36 00 00 37 9F 01 00
			03 36 00 00 37 AC A0 00
			03 36 00 00 37 C7 A8 00
			03 36 00 00 38 80 00 00
			03 36 00 00 38 81 00 00
			03 36 00 00 35 03 88 00
			03 36 00 00 32 08 10 00
			03 36 00 00 32 0D 00 00
			03 36 00 00 32 08 A0 00
			03 36 00 00 38 42 00 00
			03 36 00 00 38 0E 04 00
			03 36 00 00 38 0F 38 00
			03 36 00 00 35 00 00 00
			03 36 00 00 35 01 04 00
			03 36 00 00 35 02 1C 00
			03 36 00 00 38 20 88 00
			03 36 00 00 37 16 24 00
			03 36 00 00 01 00 01 00
			00 00 00 00
		];
		gain_cmd_oft = <3176>;
		gain_cmd_size = <304>;
		expt_cmd_oft = <3480>;
		expt_cmd_size = <48>;
	};
};

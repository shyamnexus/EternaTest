&fastboot {
	hdal-mem {
		comn_blk_0 = <0x0 0x18011000 0x0 0x5dd600>;
		comn_blk_1 = <0x0 0x185ef000 0x0 0x5dd600>;
		comn_blk_2 = <0x0 0x18bce000 0x0 0x5d8600>;
		comn_blk_3 = <0x0 0x191a7000 0x0 0x5d8600>;
		comn_blk_4 = <0x0 0x19780000 0x0 0x5d8600>;
		comn_blk_5 = <0x0 0x19d59000 0x0 0x5d8600>;
		comn_blk_6 = <0x0 0x1a333000 0x0 0x70a00>;
		comn_blk_7 = <0x0 0x1a3a4000 0x0 0x70a00>;
		comn_blk_8 = <0x0 0x1a415000 0x0 0x70a00>;
		comn_blk_cnt = <9>;
		misc_cpool0_pool_type = <103>;
		misc_cpool0_blk_cnt = <2>;
		misc_cpool0_blk_0 = <0x0 0x1a487000 0x0 0x34000>;
		misc_cpool0_blk_1 = <0x0 0x1a4bc000 0x0 0x34000>;
		vprc_ctrl_0 = <0x0 0x1a4f2000 0x0 0x99880>;
		venc_max_0 = <0x0 0x1a58d000 0x0 0x1307f84>;
		venc_max_1 = <0x0 0x1b897000 0x0 0x12a7f84>;
		venc_max_2 = <0x0 0x1cb41000 0x0 0x1e3384>;
	};
};

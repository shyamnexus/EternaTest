/*
 * Novatek Ltd. BSP part of dts
 */

/ {
	i2c0: i2c1@2,f0120000 { compatible = "nvt,nvt_i2c"; reg = <0x2 0xf0120000 0x0 0x1000>; interrupts = <GIC_SPI 41 IRQ_TYPE_LEVEL_HIGH>; clock-frequency = <100000>; id = <0>; clocks = <&clk_i2c0>; clock-names = "2f0120000.i2c1"; /* gsr = <2>; */ /* tsr = <1>; */};
	//i2c1: i2c2@2,f0121000 { compatible = "nvt,nvt_i2c"; reg = <0x2 0xf0121000 0x0 0x1000>; interrupts = <GIC_SPI 42 IRQ_TYPE_LEVEL_HIGH>; clock-frequency = <100000>; id = <1>; clocks = <&clk_i2c1>; clock-names = "2f0121000.i2c2"; /* gsr = <2>; */ /* tsr = <1>; */};
	//i2c2: i2c3@2,f0122000 { compatible = "nvt,nvt_i2c"; reg = <0x2 0xf0122000 0x0 0x1000>; interrupts = <GIC_SPI 60 IRQ_TYPE_LEVEL_HIGH>; clock-frequency = <100000>; id = <2>; clocks = <&clk_i2c2>; clock-names = "2f0122000.i2c3"; /* gsr = <2>; */ /* tsr = <1>; */};
	//i2c3: i2c4@2,f0123000 { compatible = "nvt,nvt_i2c"; reg = <0x2 0xf0123000 0x0 0x1000>; interrupts = <GIC_SPI 68 IRQ_TYPE_LEVEL_HIGH>; clock-frequency = <100000>; id = <3>; clocks = <&clk_i2c3>; clock-names = "2f0123000.i2c4"; /* gsr = <2>; */ /* tsr = <1>; */};
	//i2c4: i2c5@2,f0124000 { compatible = "nvt,nvt_i2c"; reg = <0x2 0xf0124000 0x0 0x1000>; interrupts = <GIC_SPI 69 IRQ_TYPE_LEVEL_HIGH>; clock-frequency = <100000>; id = <4>; clocks = <&clk_i2c4>; clock-names = "2f0124000.i2c5"; /* gsr = <2>; */ /* tsr = <1>; */};
};

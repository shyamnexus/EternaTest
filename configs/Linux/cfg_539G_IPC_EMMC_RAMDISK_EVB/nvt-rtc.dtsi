/*
 * Novatek Ltd. BSP part of dts
 *
 * CLK_DIV_OFFSET = (crystal_frequency - 32763) * 32
 */

/ {

#if 1
	rtc_en_part  {
		  /*<temperature compensation function enable >*/
		  rtc_tempcom_func_en =
				<0      >;
    };
#endif

    rtc_part {
    	/* < Temperature > 0>, <Temperature (c)>, <CLK_DIV_OFFSET> */
          offset =
           		<0       >,<28      >, <9      >, // -28 , 9
                <0       >,<18      >, <52     >, // -18 , 52
                <0       >,<8       >, <89     >, // -8  , 89
                <1       >,<2       >, <117    >, // 2   , 117
                <1       >,<12      >, <140    >, // 12  , 140
                <1       >,<22      >, <158    >, // 22  , 158
                <1       >,<31      >, <168    >, // 31  , 168
                <1       >,<42      >, <170    >, // 42  , 170
                <1       >,<52      >, <166    >, // 52  , 166
                <1       >,<63      >, <154    >, // 63  , 154
                <1       >,<73      >, <133    >, // 73  , 133
                <1       >,<85      >, <102    >, // 85  , 102
                <1       >,<92      >, <79     >; // 92  , 79
    };
};


/*
 * Novatek Ltd. BSP part of dts
 */
 
/ {
	nvt_info {						/* Get from ModelConfig.txt */
		BIN_NAME = "FW98538A";
		BIN_NAME_T = "FW98538T";
		/* EMBMEM_BLK_SIZE, Normally, 2KPageNand=0x20000, 512PageNand=0x4000, SPI=0x10000 */
		EMBMEM_BLK_SIZE = "0x20000";

		/*
		 * [EMBMEM]
		 * EMBMEM_NONE
		 * EMBMEM_NAND
		 * EMBMEM_SPI_NOR
		 * EMBMEM_SPI_NAND
		 * EMBMEM_EMMC
		 */
		EMBMEM = "EMBMEM_SPI_NAND";
		/*
		 * ======= Linux common =========
		 * application/external
		 */
		NVT_CFG_APP_EXTERNAL = "dhd_priv memtester iperf-3";
		/* application include list */
		NVT_CFG_APP = "mem sw_dbg i2c_access";
		/* rootfs etc folder */
		NVT_ROOTFS_ETC = "COMMON";
		/* strip executable binary and library files: yes/no */
		NVT_BINARY_FILE_STRIP = "yes";
		/* Using customized kernel config */
		NVT_CFG_KERNEL_CFG = "ns02302_ipc_a64_tee_evb_defconfig_release";
		/* Using customized uboot config */
		NVT_CFG_UBOOT_CFG = "nvt-ns02302_a64_tee_secboot_nand_defconfig";

		/*
		 * ======= OPTEE CPU core number setting =========
		 * [NVT_OPTEE_CORE_NUM]
		 */
		NVT_OPTEE_CORE_NUM = "2";

		/*
		 * ======= Linux for different code setting =========
		 * [NVT_LINUX_SMP]
		 * NVT_LINUX_SMP_ON
		 * NVT_LINUX_SMP_OFF
		 */
		NVT_LINUX_SMP = "NVT_LINUX_SMP_ON";

		/*
		 * ======= FPGA emulation  =========
		 * [NVT_FPGA_EMULATION]
		 * NVT_FPGA_EMULATION_ON
		 * NVT_FPGA_EMULATION_OFF
		 */
		NVT_FPGA_EMULATION = "NVT_FPGA_EMULATION_OFF";

		/*
		 * [NVT_DEFAULT_NETWORK_BOOT_PROTOCOL]
		 * NVT_DEFAULT_NETWORK_BOOT_PROTOCOL_DHCP_SERVER
		 * NVT_DEFAULT_NETWORK_BOOT_PROTOCOL_DHCP_CLIENT
		 * NVT_DEFAULT_NETWORK_BOOT_PROTOCOL_STATIC_IP
		 */
		NVT_DEFAULT_NETWORK_BOOT_PROTOCOL = "NVT_DEFAULT_NETWORK_BOOT_PROTOCOL_STATIC_IP";

		/*
		 * [NVT_ROOTFS_TYPE]
		 * NVT_ROOTFS_TYPE_NAND_UBI
		 * NVT_ROOTFS_TYPE_NAND_SQUASH_NEW
		 * NVT_ROOTFS_TYPE_NAND_JFFS2
		 * NVT_ROOTFS_TYPE_NOR_SQUASH
		 * NVT_ROOTFS_TYPE_NOR_JFFS2
		 * NVT_ROOTFS_TYPE_RAMDISK
		 * NVT_ROOTFS_TYPE_EXT4
		 */
		NVT_ROOTFS_TYPE = "NVT_ROOTFS_TYPE_RAMDISK";

		/*
		 * [NVT_ETHERNET]
		 * NVT_ETHERNET_NONE
		 * NVT_ETHERNET_EQOS
		 */
		NVT_ETHERNET = "NVT_ETHERNET_EQOS";

		/**
		 * [LCD1]
		 * disp_if8b_lcd1_wm08001_sn75lvds83b
		 * disp_if8b_lcd1_aucn01
		 * disp_ifdsi_lcd1_nt35510
		 * disp_if8b_lcd1_pw35p00
		 */
		LCD1 = "disp_if8b_lcd1_pw35p00";

		/**
		 * [LCD2]
		 * disp_if8b_lcd2_aucn01
		 * disp_ifdsi_lcd2_nt35510
		 * disp_if8b_lcd2_pw35p00
		 * disp_ifmi_lcd2_ili9163c
		 */
		LCD2 = "disp_if8b_lcd2_pw35p00";

		/*
		 * [NVT_SDIO_WIFI]: Remember to update root-fs/rootfs/etc/init.d/S05_Net
		 * NVT_SDIO_WIFI_NONE
		 * NVT_SDIO_WIFI_RTK
		 * NVT_SDIO_WIFI_BRCM
		 * NVT_SDIO_WIFI_NVT
		 */
		NVT_SDIO_WIFI = "NVT_SDIO_WIFI_NONE";

		/*
		 * [NVT_USB_WIFI]
		 * NVT_USB_WIFI_NONE
		 */
		NVT_USB_WIFI = "NVT_USB_WIFI_NONE";

		/*
		 * [NVT_USB_4G]
		 * NVT_USB_4G_NONE
		 */
		NVT_USB_4G = "NVT_USB_4G_NONE";

		/*
		 * [WIFI_RTK_MDL]  : sub item for NVT_SDIO_WIFI_RTK
		 * WIFI_RTK_MDL_NONE
		 * WIFI_RTK_MDL_8189
		 */
		WIFI_RTK_MDL = "WIFI_RTK_MDL_8189";

		/*
		 * [WIFI_BRCM_MDL]  : sub item for NVT_SDIO_WIFI_BRCM
		 * WIFI_BRCM_MDL_43438a1_ampk6212axtal26
		 * WIFI_BRCM_MDL_43455c0_ampk6255c0
		 */
		WIFI_BRCM_MDL = "WIFI_BRCM_MDL_43438a1_ampk6212axtal26";

		/*
		 * [WIFI_NVT_MDL]  : sub item for NVT_SDIO_WIFI_NVT
		 * WIFI_NVT_MDL_18202
		 * WIFI_NVT_MDL_18211
		 */
		WIFI_NVT_MDL = "WIFI_NVT_MDL_18211";

		/*
		 * [NVT_CURL_SSL]
		 * NVT_CURL_SSL_OPENSSL
		 * NVT_CURL_SSL_WOLFSSL
		 */
		NVT_CURL_SSL = "NVT_CURL_SSL_OPENSSL";

		/*
		 * [NVT_UBOOT_ENV_IN_STORG_SUPPORT]
		 * NVT_UBOOT_ENV_IN_STORG_SUPPORT_NAND
		 * NVT_UBOOT_ENV_IN_STORG_SUPPORT_NOR
		 * NVT_UBOOT_ENV_IN_STORG_SUPPORT_MMC
		 * NVT_UBOOT_ENV_IN_STORG_SUPPORT_OFF
		 */
		NVT_UBOOT_ENV_IN_STORG_SUPPORT = "NVT_UBOOT_ENV_IN_STORG_SUPPORT_OFF";

                /*
                * [ENCRYPT_MSG]
                * ENCRYPT_MSG_ON
                * ENCRYPT_MSG_OFF
                */
                ENCRYPT_MSG = "ENCRYPT_MSG_ON";

                /*
                * [ENCRYPT_DTS]
                * ENCRYPT_DTS_ON
                * ENCRYPT_DTS_OFF
                */
                ENCRYPT_DTS = "ENCRYPT_DTS_ON";

                /*
                * [ENCRYPT_ATF]
                * ENCRYPT_ATF_ON
                * ENCRYPT_ATF_OFF
                */
                ENCRYPT_ATF = "ENCRYPT_ATF_ON";

                /*
                * [ENCRYPT_OPTEE]
                * ENCRYPT_OPTEE_ON
                * ENCRYPT_OPTEE_OFF
                */
                ENCRYPT_OPTEE = "ENCRYPT_OPTEE_ON";

                /*
                * [ENCRYPT_UBOOT]
                * ENCRYPT_UBOOT_ON
                * ENCRYPT_UBOOT_OFF
                */
                ENCRYPT_UBOOT = "ENCRYPT_UBOOT_ON";

                /*
                * [ENCRYPT_KERNEL]
                * ENCRYPT_KERNEL_ON
                * ENCRYPT_KERNEL_OFF
                */
                ENCRYPT_KERNEL = "ENCRYPT_KERNEL_ON";

		/*
                * [ENCRYPT_ROOTFS]
                * ENCRYPT_ROOTFS_ON
                * ENCRYPT_ROOTFS_OFF
                */
                ENCRYPT_ROOTFS = "ENCRYPT_ROOTFS_OFF";

                /*
                 * [SIGNATUREMETHOD]
                 * SIGNATUREMETHOD_RSA2048
                 * SIGNATUREMETHOD_ECDSA
                 */
                SIGNATUREMETHOD = "SIGNATUREMETHOD_ECDSA";

		/*
                 * [CHECK_SIGNATURE_BEFORE_BOOT]
                 * CHECK_SIGNATURE_BEFORE_BOOT_ON
                 * CHECK_SIGNATURE_BEFORE_BOOT_OFF
                 */
                CHECK_SIGNATURE_BEFORE_BOOT = "CHECK_SIGNATURE_BEFORE_BOOT_OFF";

	};
};

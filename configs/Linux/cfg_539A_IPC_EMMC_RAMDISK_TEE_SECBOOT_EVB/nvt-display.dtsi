/*
 * Novatek Ltd. BSP part of dts
 */

/ {
	display {
		type = "lcd";
		lcd_ctrl = <1>;
		sif_channel = <2>;
		gpio_cs = <P_GPIO(0)>;
		gpio_clk = <P_GPIO(1)>;
		gpio_data = <P_GPIO(2)>;
	};
	display2 {
		type = "lcd";
		lcd_ctrl = <1>;
		sif_channel = <2>;
		gpio_cs = <P_GPIO(0)>;
		gpio_clk = <P_GPIO(1)>;
		gpio_data = <P_GPIO(2)>;
	};
	logo { enable = <0>; lcd_type=<0>; };
};

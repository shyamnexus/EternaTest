/*
 * Novatek Ltd. NA51000 BSP part of dts
 *
 * Cortex-A53
 *
 */

/dts-v1/;
#include <dt-bindings/gpio/gpio.h>
#include <dt-bindings/interrupt-controller/arm-gic.h>

/ {
	#address-cells = <2>;
	#size-cells = <2>;
	aliases {
		mmc0 = &mmc0;	/* Fixed to mmcblk0 for sdio1 */
	};

	mmc0: mmc@4,f07b0000 {
		compatible = "nvt,nvt_mmc";
		reg = <0x4 0xf07b0000 0x0 0x1000>;
		max-frequency = <48000000>;
		voltage-switch = <0>;
		max-voltage = <3300>;
		bus-width = <4>;
		driving = <7 7 7 7 7 7 7 7 7 7 7 7>;
		/*card_power_gpio = <P_GPIO(0) GPIO_LOW>;*/
		/*ro_gpio = <D_GPIO(1) GPIO_RISING_EDGE GPIO_POLLING>;*/
		/*power_en = <D_GPIO(2) GPIO_RISING_EDGE>;*/
	};
};

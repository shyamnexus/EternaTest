/*
 * Novatek Ltd. NA51000 BSP part of dts
 *
 * Cortex-A53
 *
 */

/dts-v1/;
#include <dt-bindings/gpio/gpio.h>
#include <dt-bindings/interrupt-controller/arm-gic.h>

/ {
	#address-cells = <1>;
	#size-cells = <1>;
	aliases {
		mmc0 = &mmc0;	/* Fixed to mmcblk0 for sdio1 */
	};

        mmc0: mmc@f0420000 {
                compatible = "nvt,nvt_mmc";
                reg = <0xf0420000 0x1000>;
                max-frequency = <48000000>;
                voltage-switch = <0>;
                max-voltage = <3300>;
                bus-width = <4>;
                driving = <10 10 10 15 15 15 25 25 25 25 25 25>;
                /*card_power_gpio = <P_GPIO(0) GPIO_LOW>;*/
                /*ro_gpio = <D_GPIO(1) GPIO_RISING_EDGE GPIO_POLLING>;*/
                /*power_en = <D_GPIO(2) GPIO_RISING_EDGE>;*/
        };
};

## BSP/u-boot/arch/arm/mach-novatek/Kconfig
```kconfig
if ARCH_NOVATEK

choice
	prompt "NovaTek board select"

config TARGET_NA51000
	bool "NovaTek NA51000 family SoC"
	# CPU is V7A with cache line size is 64
	select CPU_V7A
	select ARCH_MISC_INIT
	select MISC_INIT_R
	select NVT_IVOT_SOC
	help
	  The Novatek NA51000 series are the ARM-based SoC with a single core Cortex-A53

config TARGET_NA51000_A64
	bool "NovaTek NA51000 family A64 SoC"
	# CPU is V7A with cache line size is 64
	select ARM64
	select ARCH_MISC_INIT
	select MISC_INIT_R
	select NVT_IVOT_SOC
	help
	  The Novatek NA51000 series are the ARM-based SoC with a single core Cortex-A53

config TARGET_NA51055
	bool "NovaTek NA51055 family SoC"
	# CPU is V7A with cache line size is 32
	select CPU_V7A
	select ARCH_MISC_INIT
	select MISC_INIT_R
	select NVT_IVOT_SOC
	help
	  The Novatek NA51055 series are the ARM-based SoC with a single core Cortex-A9.

config TARGET_NA51068
	bool "NovaTek NA51068 family SoC"
	# CPU is V7A with cache line size is 32
	select CPU_V7A
	select ARCH_MISC_INIT
	select MISC_INIT_R
	select NVT_IVOT_SOC
	help
	  The Novatek NA51068 series are the ARM-based SoC with a dual core Cortex-A9.

config TARGET_NA51089
	bool "NovaTek NA51089 family SoC"
	# CPU is V7A with cache line size is 32
	select CPU_V7A
	select ARCH_MISC_INIT
	select MISC_INIT_R
	select NVT_IVOT_SOC
	help
	  The Novatek NA51089 series are the ARM-based SoC with a single core Cortex-A9.

config TARGET_NA51090
	bool "NovaTek NA51090 family SoC"
	# CPU is V7A with cache line size is 64
	select CPU_V7A
	select ARCH_MISC_INIT
	select MISC_INIT_R
	select NVT_IVOT_SOC
	help
	  The Novatek NA51090 series are the ARM-based SoC with a quad core Cortex-A53

config TARGET_NA51090_A64
	bool "NovaTek NA51090 family A64 SoC"
	# CPU is V7A with cache line size is 64
	select ARM64
	select ARCH_MISC_INIT
	select MISC_INIT_R
	select NVT_IVOT_SOC
	help
	  The Novatek NA51090 series are the ARM-based SoC with a quad core Cortex-A53

config TARGET_NA51102
	bool "NovaTek NA51102 family SoC"
	# CPU is V7A with cache line size is 64
	select CPU_V7A
	select ARCH_MISC_INIT
	select MISC_INIT_R
	select NVT_IVOT_SOC
	help
	  The Novatek NA51102 series are the ARM-based SoC with a quad core Cortex-A53

config TARGET_NA51102_A64
	bool "NovaTek NA51102 family A64 SoC"
	select ARM64
	select ARCH_MISC_INIT
	select MISC_INIT_R
	select NVT_IVOT_SOC
	help
	  The Novatek NA51102 series are the ARM-based SoC with a quad core Cortex-A53

config TARGET_NA51103
	bool "NovaTek NA51103 family SoC"
	select CPU_V7A
	select ARCH_MISC_INIT
	select MISC_INIT_R
	select NVT_IVOT_SOC
	help
	  The Novatek NA51103 series are the ARM-based SoC with a dual core Cortex-A53

config TARGET_NA51103_A64
	bool "NovaTek NA51103 family A64 SoC"
	select ARM64
	select ARCH_MISC_INIT
	select MISC_INIT_R
	select NVT_IVOT_SOC
	help
	  The Novatek NA51103 series are the ARM-based SoC with a dual core Cortex-A53

config TARGET_NS02201
	bool "NovaTek NS02201 family SoC"
	select CPU_V7A
	select ARCH_MISC_INIT
	select MISC_INIT_R
	select NVT_IVOT_SOC
	help
	  The Novatek NS02201 series are the ARM-based SoC with a quad core Cortex-A73

config TARGET_NS02201_A64
	bool "NovaTek NS02201 family A64 SoC"
	select ARM64
	select ARCH_MISC_INIT
	select MISC_INIT_R
	select NVT_IVOT_SOC
	help
	  The Novatek NS02201 series are the ARM-based SoC with a quad core Cortex-A73

config TARGET_NS02301
    bool "NovaTek NS02301 family SoC"
    select CPU_V7A
    select ARCH_MISC_INIT
    select MISC_INIT_R
    select NVT_IVOT_SOC
    help
      The Novatek NS02301 series are the ARM-based SoC with a dual core Cortex-A7

config TARGET_NS02302_A64
	bool "NovaTek NS02302 family A64 SoC"
	select ARM64
	select ARCH_MISC_INIT
	select MISC_INIT_R
	select NVT_IVOT_SOC
	help
	  The Novatek NS02302 series are the ARM-based SoC with a quad core Cortex-A53

config TARGET_NS02401_A64
	bool "NovaTek NS02401 family A64 SoC"
	select ARM64
	select ARCH_MISC_INIT
	select MISC_INIT_R
	select NVT_IVOT_SOC
	help
	  The Novatek NS02401 series are the ARM-based SoC with a quad core Cortex-A76


config TARGET_NS02401_V0_A64
	bool "NovaTek NS02401 V0 family A64 SoC"
	select ARM64
	select ARCH_MISC_INIT
	select MISC_INIT_R
	select NVT_IVOT_SOC
	help
	  The Novatek NS02401 series are the ARM-based SoC with a quad core Cortex-A76

endchoice

config NVT_DISABLE_CFG_CHK
	string
	default y

config SYS_MALLOC_LEN
	hex
	default 0x300000

config NVT_BOARD
	bool
	default y

# To inculde basic arch config
source "arch/arm/mach-novatek/nvt_na51055_a32/Kconfig"
source "arch/arm/mach-novatek/nvt_na51089_a32/Kconfig"
source "arch/arm/mach-novatek/nvt_na51090_a32/Kconfig"
source "arch/arm/mach-novatek/nvt_na51090_a64/Kconfig"
source "arch/arm/mach-novatek/nvt_na51102_a32/Kconfig"
source "arch/arm/mach-novatek/nvt_na51102_a64/Kconfig"
source "arch/arm/mach-novatek/nvt_na51103_a32/Kconfig"
source "arch/arm/mach-novatek/nvt_na51103_a64/Kconfig"
source "arch/arm/mach-novatek/nvt_ns02201_a32/Kconfig"
source "arch/arm/mach-novatek/nvt_ns02201_a64/Kconfig"
source "arch/arm/mach-novatek/nvt_ns02301_a32/Kconfig"
source "arch/arm/mach-novatek/nvt_ns02302_a64/Kconfig"
source "arch/arm/mach-novatek/nvt_ns02401_a64/Kconfig"
source "arch/arm/mach-novatek/nvt_ns02401_v0_a64/Kconfig"
endif
```

## BSP/u-boot/board/novatek/common/Kconfig
```kconfig
menu "Novatek IVOT features"
config NVT_IVOT_SOC
	bool "Novatek IVOT series soc"
	help
	  This option can be used to enable ivot features.

config NVT_IVOT_QEMU_SIM
        bool "Novatek IVOT virtual platform (vp)"
	depends on NVT_IVOT_SOC
	default n
        help
          This option can be used to enable ivot vp qemu simulation

config NVT_FPGA_EMULATION
	bool "Novatek IVOT FPGA emulation"
	default n
	help
	  This option can be used to enable FPGA emulation.

config NVT_IVOT_SOC_FW_UPDATE_SUPPORT
	bool "Novatek IVOT FW update utils"
	depends on ARCH_NOVATEK && NVT_IVOT_SOC_UTILS
	default n
	help
	  This option can be used to support fdt parsing and update api.

config NVT_BIN_CHKSUM_SUPPORT
	bool "Novatek IVOT verify FW checksum"
	depends on NVT_IVOT_SOC_FW_UPDATE_SUPPORT
	default y
	help
	  This option is used to verify FW checksum.

config NVT_LINUX_EMMC_BOOT
	bool "Novatek IVOT EMMC boot support"
	depends on NVT_IVOT_SOC_FW_UPDATE_SUPPORT
	depends on NVT_IVOT_EMMC >= 0
	default y
	help
	  This option is used to EMMC boot.

config NVT_LINUX_SPINAND_BOOT
	bool "Novatek IVOT NAND boot support"
	depends on NVT_IVOT_SOC_FW_UPDATE_SUPPORT
	depends on NVT_SPI_NAND
	default y
	help
	  This option is used to NAND boot.

config NVT_LINUX_SPINOR_BOOT
	bool "Novatek IVOT NOR boot support"
	depends on NVT_IVOT_SOC_FW_UPDATE_SUPPORT
	depends on NVT_SPI_NOR
	default y
	help
	  This option is used to NOR boot.

config NVT_LINUX_SPINORNAND_BOOT
	bool "Novatek IVOT NOR + NAND boot support"
	depends on NVT_IVOT_SOC_FW_UPDATE_SUPPORT
	depends on NVT_SPI_NOR_NAND
	default y
	help
	  This option is used to NOR + NAND boot.

config NVT_LINUX_SD_BOOT
	bool "Novatek IVOT SD boot support"
	depends on NVT_IVOT_SOC_FW_UPDATE_SUPPORT
	default y
	help
	  This option is used to SD boot.

config NVT_IVOT_SOC_UTILS
	bool "Novatek IVOT utils"
	default n
	help
	  To support IVOT proprietary utilities.

config NVT_IVOT_SOC_BOOT_FROM_RAM
	bool "Novatek IVOT FW boot from ram"
	default n
	help
	  To support IVOT FW only boot from ram.

config NVT_IVOT_NVT_DBG
	bool "Novatek IVOT debug setting"
	default n
	help
	  To support IVOT message debug function.

config NVT_IVOT_DEBUG_LEVEL
	int "Debug msg print level (0-8)"
        default 4
        depends on NVT_IVOT_NVT_DBG
        help
          0 ~ 8: 8 is to turn on all print message

config NVT_IVOT_SECBOOT_SUPPORT
	bool "To support secure boot flow"
	depends on !NVT_IVOT_OPTEE_SECBOOT_SUPPORT
	depends on NVT_CRYPTO
	depends on NVT_HASH
	depends on NVT_RSA || NVT_ECDSA
	default n
	  help
	    To support secure boot flow without optee

config NVT_IVOT_OPTEE_SUPPORT
	bool "To support the optee utils"
	default n
	help
	  This option is used to communicate with optee secure os.

config NVT_IVOT_OPTEE_SECBOOT_SUPPORT
	bool "To support secure boot flow with optee"
	depends on NVT_IVOT_OPTEE_SUPPORT
	default n
	help
	  To support secure boot flow with optee

config NVT_PCIE_DAUGHTER_BRD
	bool "Enable nvt pcie daughter board"
	depends on NVT_IVOT_SOC_UTILS
	default n
	help
	  This option is used to enable NVT pcie boot daughter board.

config NVT_UTILS_CMD
	bool "Novatek IVOT command support"
	depends on ARCH_NOVATEK
	default y
	help
	  This option is used to enable nvt command.

config NVT_IVOT_DDR_RANGE_SCAN_SUPPORT
	bool "To support DDR range scan utils"
	depends on NVT_UTILS_CMD
	default n
	help
	  This option is used to lunch range scan.

	if NVT_IVOT_DDR_RANGE_SCAN_SUPPORT
    	menu "Novatek DDR scan uart selection"
			
			config NVT_DDR_SCAN_OUTPUT_MESSAGE_TO_UART0
				bool "DDR range scan utils output message to UART0"

			config NVT_DDR_SCAN_OUTPUT_MESSAGE_TO_UART1
				bool "DDR range scan utils output message to UART1"

			config NVT_DDR_SCAN_OUTPUT_MESSAGE_TO_UART2
				bool "DDR range scan utils output message to UART2"

        endmenu
	endif

config NVT_IVOT_STBC_PMC_SUPPORT
	bool "To support STBC power down utils"
	depends on TARGET_NA51102_A64
	depends on NVT_UTILS_CMD
	default n
	help
	  This option is used to lunch range scan.

config NVT_IVOT_TZPC_SUPPORT
	bool "To support TZPC related utils"
	depends on NVT_UTILS_CMD
	default n
	help
	  This option is used to simple verify TZPC.

config NVT_IVOT_BOOT_FAST
	bool "Let your uboot booting time faster"
	depends on NVT_UTILS_CMD
	default n
	help
	  This option can be used to accelerate boot time.

config VIDEO_LOGO
	bool "To support display LOGO"
	depends on NVT_UTILS_CMD
	default n
	help
	  This option is used to lunch display LOGO.

config NVT_IVOT_CRYPTO_CMD
	bool "To support crypto engine command"
	depends on NVT_IVOT_SOC && NVT_IVOT_OPTEE_SUPPORT=n
	depends on NVT_UTILS_CMD
	help
	  Novatek iVot Crypto Engine Command support.

config NVT_IVOT_HASH_CMD
	bool "To support hash engine command"
	depends on NVT_IVOT_SOC && NVT_IVOT_OPTEE_SUPPORT=n
	depends on NVT_UTILS_CMD
	help
	  Novatek iVot Hash Engine Command support.

config NVT_IVOT_RSA_CMD
	bool "To support rsa engine command"
	depends on NVT_IVOT_SOC && NVT_IVOT_OPTEE_SUPPORT=n
	depends on NVT_UTILS_CMD
	help
	  Novatek iVot RSA Engine Command support.

config NVT_IVOT_ECDSA_CMD
	bool "To support ecdsa engine command"
	depends on NVT_IVOT_SOC && NVT_IVOT_OPTEE_SUPPORT=n
	depends on NVT_UTILS_CMD
	help
	  Novatek iVot ECDSA Engine Command support.

config NVT_IVOT_EFUSE_CMD
	bool "To support efuse engine command"
	depends on NVT_IVOT_SOC && NVT_IVOT_SOC_UTILS
	depends on NVT_UTILS_CMD
	default y
	help
	  Novatek iVot EFUSE Engine Command support.

config NVT_IVOT_DUAL_RTOS
	bool "Dual RTOS mechanism"
	default n
	help
	  An alternate rtos mechanism only for RTOS_APP_MAIN = uvc

config NVT_SWITCH_SECURE
	bool "To support switch to novatek secure boot flow"
	default n
	help
	  Novatek iVot switch to secure boot command support.

endmenu		# Novatek IVOT features
```

## BSP/u-boot/board/novatek/nvt-ns02201-a64/nvt_pcie/Kconfig
```kconfig
if ARCH_NOVATEK
	if TARGET_NS02201_A64
		menu "Novatek PCIE EP features"

		config NVT_PCIE_EP_VENDOR_ID
				hex "NVT PCIE EP Vendor ID"
				depends on NVT_PCIE_DAUGHTER_BRD && PHY_NOVATEK_PCIE_V2
				default 0x1E09
				help
				Overwrite your EP PCIE VID

		config NVT_PCIE_EP_DEV_ID
				hex "NVT PCIE EP Device ID"
				depends on NVT_PCIE_DAUGHTER_BRD && PHY_NOVATEK_PCIE_V2
				default 0x0006
				help
				Overwrite your EP PCIE PID

		config NVT_PCIE_EP_BAR0_SIZE
				int "NVT PCIE EP BAR0 size"
				depends on NVT_PCIE_DAUGHTER_BRD && PHY_NOVATEK_PCIE_V2
				default 5
				range 0 13
				help
				0:		1 MB (2^20)
				1:		2 MB (2^21)
				N:		2^(20+N)
				5:		32 MB (2^25) (default)
				...
				13:		8 GB (2^33) (max)

		config NVT_PCIE_EP_BAR2_EN
				bool "NVT PCIE EP BAR2 enabled"
				depends on NVT_PCIE_DAUGHTER_BRD && PHY_NOVATEK_PCIE_V2
				default y
				help
				Enable/Disable EP PCIE BAR2

		endmenu
	endif
endif # ARCH_NOVATEK
```

## BSP/u-boot/drivers/crypto/Kconfig
```kconfig
menu "Hardware crypto devices"

source drivers/crypto/fsl/Kconfig

if TARGET_NA51102 || TARGET_NA51102_A64
source drivers/crypto/nvt/na51102/Kconfig
endif

if TARGET_NS02401 || TARGET_NS02401_A64
source drivers/crypto/nvt/ns02401/Kconfig
endif

if TARGET_NS02201 || TARGET_NS02201_A64
source drivers/crypto/nvt/ns02201/Kconfig
endif

if TARGET_NS02302 || TARGET_NS02302_A64
source drivers/crypto/nvt/ns02302/Kconfig
endif

if TARGET_NS02301 || TARGET_NS02301_A32
source drivers/crypto/nvt/ns02301/Kconfig
endif

if TARGET_NA51103|| TARGET_NA51103_A32
source drivers/crypto/nvt/na51103/Kconfig
endif

if TARGET_NA51089|| TARGET_NA51089_A32
source drivers/crypto/nvt/na51089/Kconfig
endif

endmenu
```

## BSP/u-boot/drivers/crypto/nvt/ns02302/Kconfig
```kconfig
config NVT_CRYPTO
	bool "NovaTek NS02302 Crypto Driver Support"
	depends on NVT_IVOT_SOC && NVT_IVOT_OPTEE_SUPPORT=n
	help
	  Novatek NS02302 processors have crypto engine accelerator.
	  Select this if you want to use the crypto engine for AES/DES/3DES
	  algorithms.

config NVT_HASH
	bool "NovaTek NS02302 Hash Driver Support"
	depends on NVT_IVOT_SOC && NVT_IVOT_OPTEE_SUPPORT=n
	help
	  Novatek NS02302 processors have hash engine accelerator.
	  Select this if you want to use the hash engine for SHA1/SHA256 algorithms.

config NVT_RSA
	bool "NovaTek NS02302 RSA Driver Support"
	depends on NVT_IVOT_SOC && NVT_IVOT_OPTEE_SUPPORT=n
	help
	  Novatek NS02302 processors have rsa engine accelerator.
	  Select this if you want to use the rsa engine.

config NVT_ECDSA
	bool "NovaTek NS02302 ECDSA Driver Support"
	depends on NVT_IVOT_SOC && NVT_IVOT_OPTEE_SUPPORT=n
	help
	  Novatek NS02302 processors have ecdsa engine accelerator.
	  Select this if you want to use the ecdsa engine.
```

## BSP/u-boot/drivers/mtd/spiflash/Kconfig
```kconfig
choice
	prompt "Support for NVT IVOT Flash Controller"
	default NVT_SPI_NAND
	depends on NVT_IVOT_SOC

config NVT_SPI_NONE
	tristate "Not Support for NVT IVOT Flash Controller"
	depends on (NVT_IVOT_SOC)
	help
	  Disable support for Novatek NAND Flash Controller.

config NVT_SPI_NAND
	tristate "Support for NVT IVOT NAND Flash Controller"
	depends on (NVT_IVOT_SOC)
	help
	  Enable support for Novatek NAND Flash Controller.

config NVT_SPI_NOR
	tristate "Support for NVT IVOT NOR Flash Controller"
	depends on (NVT_IVOT_SOC)
	help
	  Enable support for Novatek NOR Flash Controller.

config NVT_SPI_NOR_NAND
	tristate "Support for NVT IVOT NOR NAND Flash Controller"
	depends on (NVT_IVOT_SOC)
	help
	  Enable support for Novatek NOR NAND Flash Controller.

endchoice

config FLASH_ONLY_DUAL
	bool "Only Support dual mode access"
	depends on (NVT_SPI_NAND || NVT_SPI_NOR || NVT_SPI_NOR_NAND)
	help
	  Dual mode supports.
	  Force flash operations under dual mode.
```

## BSP/u-boot/drivers/phy/novatek/Kconfig
```kconfig
#
# Phy drivers for Novatek platforms
#
config PHY_NOVATEK_PCIE_V2
        bool "Novatek PCIe PHY (V2) driver"
        depends on TARGET_NS02201_A64 && (PCI || NVT_PCIE_DAUGHTER_BRD)
	select PHY
        default n
        help
          Enable this to support the Novatek PCIe PHY.

config PHY_NOVATEK_PCIE_V3
        bool "Novatek PCIe PHY (V3) driver"
        depends on TARGET_NS02401_A64 && (PCI || NVT_PCIE_DAUGHTER_BRD)
	select PHY
        default n
        help
          Enable this to support the Novatek PCIe PHY.
```

## BSP/u-boot/drivers/pinctrl/novatek/Kconfig
```kconfig
if ARCH_NOVATEK

config PINCTRL_NTK
	depends on PINCTRL_GENERIC
	bool

config PINCTRL_NS02302
	bool "Novatek NS02302 pin control"
	depends on TARGET_NS02302_A64
	select PINCTRL_NTK

endif
```

## BSP/linux-kernel/drivers/clk/novatek/Kconfig
```kconfig
config COMMON_CLK_NVT
	tristate "Clock driver for Novatek"
	depends on COMMON_CLK && OF
	depends on PLAT_NOVATEK

config COMMON_CLK_NVT_EP
	tristate "PCI EP Clock driver for Novatek"
	depends on COMMON_CLK && OF
	depends on PLAT_NOVATEK

config COMMON_CLK_NA51055
        bool "Clock driver for Novatek NA51055"
        depends on NVT_IVOT_PLAT_NA51055

config COMMON_CLK_NA51102
	bool "Clock driver for Novatek NA51102"
	depends on NVT_IVOT_PLAT_NA51102

config COMMON_CLK_NA51103
	bool "Clock driver for Novatek NA51103"
	depends on NVT_IVOT_PLAT_NA51103

config COMMON_CLK_NA51089
        bool "Clock driver for Novatek NA51089"
        depends on NVT_IVOT_PLAT_NA51089

config COMMON_CLK_NA51090
	bool "Clock driver for Novatek NA51090"
	depends on NVT_IVOT_PLAT_NA51090

config COMMON_CLK_NA51090_EP
        tristate "Clock driver for Novatek NA51090 PCIE EPs"
        depends on NVT_IVOT_PLAT_NA51090
```

## BSP/linux-kernel/drivers/crypto/nvt_ivot/Kconfig
```kconfig
config CRYPTO_DEV_NVT_IVOT_NS02201_CRYPTO
	tristate "Novatek NS02201 crypto hardware engine"
	depends on TEE=n && OPTEE=n
	select CRYPTO_AES
	select CRYPTO_DES
	select CRYPTO_CBC
	select CRYPTO_ECB
	select CRYPTO_CFB
	select CRYPTO_OFB
	select CRYPTO_CTR
	select CRYPTO_CCM
	select CRYPTO_GCM
	select CRYPTO_ALGAPI
	select CRYPTO_BLKCIPHER
	help
	  Novatek NS02201 processors have crypto engine accelerator.
	  Select this if you want to use the crypto engine for AES/DES/3DES
	  algorithms.

config CRYPTO_DEV_NVT_IVOT_NS02201_HASH
	tristate "Novatek NS02201 hash hardware engine"
	depends on TEE=n && OPTEE=n
	select CRYPTO_HASH
	select CRYPTO_SHA1
	select CRYPTO_SHA256
	select CRYPTO_HMAC
	help
	  Novatek NS02201 processors have hash engine accelerator.
	  Select this if you want to use the hash engine for SHA1/SHA256 algorithms.

config CRYPTO_DEV_NVT_IVOT_NS02201_RSA
	tristate "Novatek NS02201 rsa hardware engine"
	depends on TEE=n && OPTEE=n
	select CRYPTO_RSA
	help
	  Novatek NS02201 processors have rsa engine accelerator.
	  Select this if you want to use the rsa engine.
```

## BSP/linux-kernel/drivers/media/rc/novatek_ir/Kconfig
```kconfig
config IR_NVT_FR
	tristate "Novatek IR remote receiver"
	depends on RC_CORE
	depends on ARCH_NVT_IVOT_V7 || ARCH_NVT_IVOT_V8
	help
	   Say Y if you want to use Novatek IR remote receiver
```

## BSP/linux-kernel/drivers/mtd/spiflash/Kconfig
```kconfig
config MTD_SPINAND
	tristate "NVT SPINAND Device Support"
	depends on MTD_RAW_NAND
	help
	  This enables the NAND flash controller driver for Novatek SoCs


config FLASH_ONLY_DUAL
	bool "Only Support spi-nand dual mode"
	depends on MTD_SPINAND
	help
	  Dual mode supports.
	  Force flash operations under dual mode.

config MTD_SPINOR
	tristate "NVT SPINOR Device Support"
	depends on (MTD) 
	help
	  This enables the NOR flash controller driver for Novatek SoCs

config FLASH_ONLY_DUAL
	bool "Only Support spi-nor dual mode"
	depends on MTD_SPINOR
	help
	  Dual mode supports.
	  Force flash operations under dual mode.

config MTD_EXTERNAL_FLASH_TABLE
	tristate "Using external flash table"
	depends on MTD_SPINOR
	help
	  This enables support for using external flash table
	  If you have requrired external table say yes.

	  If unsure, say no here.
```

## BSP/linux-kernel/drivers/net/ethernet/novatek/Kconfig
```kconfig
#
# network device configuration
#

config NET_VENDOR_NOVATEK
	tristate "Novatek DWC Ethernet QOS support"
        select PHYLIB
        select CRC32
        select MII
        select INET_LRO
        depends on HAS_DMA
        help
          This driver supports the DWC Ethernet QoS

if NET_VENDOR_NOVATEK

config NOVATEK_DWC_ETH_QOS_HIGHDMA
	bool "Novatek DWC Ethernet QOS support HIGH-DMA"
    default n

config TX_DESC
	int
	prompt "Tx Descriptor Number (minimum: 64)"
	default 256
	range 64 1024

config RX_DESC
	int
	prompt "Rx Descriptor Number (minimum: 64)"
	default 256
	range 64 1024

config MULTI_QUEUE
	bool "Novatek DWC Ethernet multi queue support"
    default n

config MULTI_IRQ
    bool "Novatek DWC Ethernet Multi IRQ support"
    default n
    depends on MULTI_QUEUE

config TIMESTAMP
	bool "Novatek DWC Ethernet Timestamp&ptp support"
	default n

config NOVATEK_TIMESTAMP_UPDATE_SYS_TIME
	bool "Support Update sys-time Automatically"
	default n
	depends on TIMESTAMP

config USAGECONTROL
	bool "Novatek DWC Ethernet Lower CPU Usage support"
	default n
	depends on !MULTI_QUEUE
	help
        This function supports lower CPU usage and will loss some throughput

endif #NET_VENDOR_NOVATEK
```

## BSP/linux-kernel/drivers/phy/novatek/Kconfig
```kconfig
#
# Phy drivers for Novatek platforms
#
config PHY_NOVATEK_PCIE_V1
	bool "Novatek PCIe PHY (V1) driver"
	depends on OF && (NVT_IVOT_PLAT_NA51090) && PCI
        depends on ARCH_NVT_IVOT_V8 || COMPILE_TEST
	select GENERIC_PHY
	default y
	help
	  Enable this to support the Novatek PCIe PHY.

config PHY_NOVATEK_PCIE_V2
	bool "Novatek PCIe PHY (V2) driver"
	depends on OF && (NVT_IVOT_PLAT_TC98110 || (NVT_IVOT_PLAT_NS02201&&NVT_OTP_SUPPORT)) && PCI
	select GENERIC_PHY
	default y
	help
	  Enable this to support the Novatek PCIe PHY.

config PHY_NS02201_SATA
	tristate "Novatek NS02201 SATA PHY driver"
	depends on OF && (NVT_IVOT_PLAT_NS02201)
	select GENERIC_PHY
	help
	  Enable this to support the Novatek SATA PHY.

config PHY_TC98110_SATA
	bool "Novatek TC98110 SATA PHY driver"
	depends on OF && (NVT_IVOT_PLAT_TC98110)
	select GENERIC_PHY
	help
	  Enable this to support the Novatek SATA PHY.
```

## BSP/linux-kernel/drivers/pinctrl/novatek/Kconfig
```kconfig
config PINCTRL_NA51102
	bool "Novatek NA51102 pin control"
	depends on OF && NVT_IVOT_PLAT_NA51102

config PINCTRL_NS02201
	bool "Novatek NS02201 pin control"
	depends on OF && NVT_IVOT_PLAT_NS02201

config PINCTRL_NA51055
	bool "Novatek NA51055 pin control"
	depends on OF && NVT_IVOT_PLAT_NA51055

config PINCTRL_NS02302
	bool "Novatek NS02302 pin control"
	depends on OF && NVT_IVOT_PLAT_NS02302

config PINCTRL_NS02301
        bool "Novatek NS02301 pin control"
        depends on OF && NVT_IVOT_PLAT_NS02301

config PINCTRL_NA51089
	bool "Novatek NA51089 pin control"
	depends on OF && NVT_IVOT_PLAT_NA51089

config PINCTRL_NA51090
	bool "Novatek NA51090 pin control"
	depends on NVT_IVOT_PLAT_NA51090

config PINCTRL_NA51103
	bool "Novatek NA51103 pin control"
	depends on NVT_IVOT_PLAT_NA51103

config PINCTRL_NS02401
	bool "Novatek NS02401 pin control"
	depends on NVT_IVOT_PLAT_NS02401

config PINCTRL_NA51090_EP
	tristate "Novatek NA51090 pin control EPs"
	depends on NVT_IVOT_PLAT_NA51090
```

## BSP/linux-kernel/drivers/soc/nvt/Kconfig
```kconfig
#
# Novatek SoC drivers
#
menu "NovaTek SoC drivers"
	depends on ARCH_NVT_IVOT_V7 || ARCH_NVT_IVOT_V8

source "drivers/soc/nvt/plat-novatek/Kconfig"

config NVT_OTP_SUPPORT
	bool "NVT OTP(one time programmable) support"
	depends on ARCH_NVT_IVOT_V7 || ARCH_NVT_IVOT_V8
	default y
	help
	  This option will configure the NVT OTP(one time programmable) function which can be used call OTP api.

config NVT_OTP_EP_SUPPORT
	tristate "NVT OTP EP(one time programmable) support"
	depends on (ARCH_NVT_IVOT_V7 || ARCH_NVT_IVOT_V8)
	depends on NVT_IVOT_PLAT_NA51090
	default n
	help
	  This option will configure the NVT OTP(one time programmable) function which can be used call OTP api.

config NVT_HDAL_BUILD_IN
	bool "Novatek IVOT HDAL for Media device drivers builtin support"
	depends on NVT_IVOT_PLAT_NS02301 || NVT_IVOT_PLAT_NS02302 || NVT_IVOT_PLAT_NA51102 || NVT_IVOT_PLAT_NA51055 || NVT_IVOT_PLAT_NA51089
	select NVT_VOS_KWRAP
	select NVT_HDAL_KDRV_BUILTIN
	default n
	help
	  Enable this option will let a part of your hdal driver link to uImage
	  You could select which module want to link in the submenu.

config NVT_HDAL_BUILT_IN_WITH_539A_IPP
        bool "Is NT98539A Series"
        depends on NVT_HDAL_BUILD_IN_ADV && NVT_IVOT_PLAT_NS02302
        default n
        help
          NT98539A Series must enable this option

config NVT_HDAL_BUILD_IN_ADV
        bool "More HDAL driver builtin"
        depends on NVT_HDAL_BUILD_IN
        default n
        help
          Enable this option will let more kdrv, kflow builtin in kernel

config NVT_HDAL_BUILD_IN_2A
        bool "2A driver builtin"
        depends on NVT_HDAL_BUILD_IN_ADV
        default y
        help
          Enable this option to use Novatek 2A algorithm

config NVT_STACK_CHECK
	bool "NVT STACK check"
	default n
	help
	  This option will check STACK overflow issue.

config NVT_PERF_MEASURE
        bool "Enable nvt_perf driver for ivot Linux kernel performance measurement"
        depends on ARCH_NVT_IVOT_V7 || ARCH_NVT_IVOT_V8
        default n
        help
                Enable nvt_perf driver for ivot Linux kernel performance measurement

config NVT_PROFILER
	bool "Novatek Profilers"
	depends on ARM || ARM64
	depends on FTRACE
	select KPROBES
	select KRETPROBES
	select EVENT_TRACING
	default n

config NVT_LOGFILE
	tristate "Novatek LOGFILE message log system"
	depends on DMA_SHARED_BUFFER
	default n
	help
	  Store serial messages into a memory buffer.
	  Logs are temporarily saved in the kernel memory for debug.

config NVT_STBC_SUPPORT
	bool "NVT stbc(stand by control) support"
	depends on ARCH_NVT_IVOT_V7 || ARCH_NVT_IVOT_V8
	depends on (NVT_IVOT_PLAT_NA51102 || NVT_IVOT_PLAT_NS02302)
	default n
	help
	  This option will configure the NVT stbc(stand by control) function which can be used call stbc api.

config NVT_AMP
        bool "NVT AMP support"
        default n
        help
          This option will configure NVT AMP function.

config NVT_CC
	bool "Novatek cc(core communication)"
	depends on NVT_IVOT_PLAT_NA51102 || NVT_IVOT_PLAT_NS02201 || NVT_IVOT_PLAT_NS02301
	default n
	help
	  This option will configure NVT CC function.

config NVT_FAST_SMP_FLOW
        bool "NVT fast boot SMP flow"
        depends on HOTPLUG_CPU && (NVT_IVOT_PLAT_NS02301 || NVT_IVOT_PLAT_NS02302 || NVT_IVOT_PLAT_NA51102)
        default n
        help
          This option will configure fast boot SMP.

config NVT_PCIE_DRIVER_INTREE
        bool "NVT PCIe device driver intree support"
        depends on PCIE_NVT || NVT_NT98690_PCI_EP_EVB
        default n
        help
          This option will configure the NVT PCI device driver to build the
          intree function, which can be used by the linux intree driver to call the API.

config NVT_ACP
	bool "Novatek Accelerator Coherence Port"
	default y
	depends on PLAT_NOVATEK && NVT_IVOT_PLAT_NS02401
	help
	  Novatek Accelerator Coherence Port.

source "drivers/soc/nvt/basic/Kconfig"

source "drivers/soc/nvt/nvt_hdal/Kconfig"

endmenu
```

## BSP/linux-kernel/drivers/soc/nvt/basic/Kconfig
```kconfig
#
# NVT BASIC SoC drivers
#
menu "NovaTek SoC Basic drivers"
	depends on ARCH_NVT_IVOT_V7 || ARCH_NVT_IVOT_V8

config NVT_INFO
	bool "NVT IVOT info for time measurement/memory hotplug...etc functions."
	default y
	help
	  Support NVT multi-functions such as boot time measurement/memory hotplug...etc.
	  We provide a tool can be used to measure booting time.
	  e.g.
		$ cat /proc/nvt_info/bootts
		$ cat /proc/nvt_info/memperf

config NVT_PCIE_LIB
	tristate "Novatek PCIe Library"
	default y
	depends on NVT_IVOT_PLAT_NA51090 || NVT_IVOT_PLAT_NA51103
	help
	  Novatek PCIe Library.

config NVT_PCIE_CASCADE_DRV
	bool "Novatek PCIe cascade"
	default y
	depends on NVT_PCIE_LIB && NVT_IVOT_PLAT_NA51090 && !PCI
	help
	  Novatek PCIe cascade.

config NVT_PCIE_COMM_DRV_EP
	tristate "Novatek PCIe Common ep driver"
	default n
	depends on NVT_IVOT_PLAT_NA51090 && (PCI || NVT_NT98336_PCI_EP_EVB)
	help
	  Novatek common PCIe controller driver for EP role.
	  It's used to provide PCIe edma and other functions in EP role of the pcie common framework.

config NVT_TIMER
	bool "Novatek hardware timer, it only supports 64-bit hardware timer engine"
	default n
	depends on PLAT_NOVATEK
	help
	  Novatek Timer.

config NVT_FB_DMABUF
	bool "Novatek DMABUF support"
	default n
	depends on PLAT_NOVATEK
	help
	  This option will support dma buffer on framebuffer.

config NVT_GPU_AFBC_SUPPORT
	bool "To support Mali GPU AFBC compression format."
	default n
	depends on PLAT_NOVATEK && (NVT_IVOT_PLAT_NS02201 || NVT_IVOT_PLAT_NS02401)
	help
	  Novatek GPU AFBC compression support

#
# For CA9 Cache flush enhancement
#
config NVT_CACHE_FLUSH_ALL_FOR_HDAL
	bool "Enable flush/clean all L2 cache operation for HDAL"
	depends on ARCH_NVT_IVOT_V7 && NVT_CACHE_FLUSH_ALL_L2_CACHE
	default y
	help
		Use flush/clean all of L2 cache instead of flush/clean range when flush/clean DRAM size over the order of L2 cache size.

config NVT_CACHE_FLUSH_ALL_THRESHOLD
	int "The threshold of flush all of L2 cache for HDAL"
	depends on NVT_CACHE_FLUSH_ALL_FOR_HDAL
	default 1
	help
		Set a threshold to judgment whether execute flush/clean all L2 cache instead of flush/clean range.
		The threshold is an order of L2 cache size. When flush/clean range over the threshold then All of L2 cache are flushed/cleaned

config NVT_CACHE_FLUSH_ALL_L2_CACHE
	bool "Enable flush/clean all L2 cache operation"
	depends on ARCH_NVT_IVOT_V7
	depends on CACHE_L2X0
	default y
	help
		When flush/clean DRAM size over the order of L2 cache size use flush/clean all of L2 cache instead of flush/clean range.

config NVT_CACHE_FLUSH_ALL_L2_THRESHOLD
	int "The threshold of flush all L2 cache"
	depends on NVT_CACHE_FLUSH_ALL_L2_CACHE
	default 1
	help
		Set a threshold to judgment whether execute flush/clean all L2 cache instead of flush/clean range.
		The threshold is an order of L2 cache size.  When flush/clean range over the threshold then all of L2 cache are flushed/cleaned

config NVT_CACHE_INVALIDATE_ALL_FOR_HDAL
	bool "Enable invalidate all L2 cache operation"
	depends on ARCH_NVT_IVOT_V7 && NVT_CACHE_FLUSH_ALL_L2_CACHE
	default n
	help
		When invalidate DRAM size over L2 cache size use flush all cache instead of invalidate range.

config NVT_CACHE_INVALIDATE_ALL_THRESHOLD
	int "The threshold of invalidate all L2 cache"
	depends on NVT_CACHE_INVALIDATE_ALL_FOR_HDAL
	default 2
	help
		Set a threshold to judgment whether execute flush all L2 cache instead of invalidate range.
		The threshold is an order of L2 cache size. When flush range over the threshold then L2 cache are flushed and invalidated
#
# For CA9 Cache flush enhancement done
#

endmenu
```
